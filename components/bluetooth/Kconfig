## components/partition_table/config/Kconfig
```kconfig
menu "Partition Table"

    config COMPONENT_PARTITION_TABLE_ENABLED
    bool
    default y
    select COMPONENT_DRIVER_HASH_ENABLED
    help
        Internal use, any modification is not allowed.

#    choice WM_CHIP_FLASH_SIZE
#        prompt "Flash size"
#        default WM_CHIP_FLASH_SIZE_2MB
#        help
#            internal flash size, in megabytes
#
#        config WM_CHIP_FLASH_SIZE_1MB
#            bool "1 MB"
#        config WM_CHIP_FLASH_SIZE_2MB
#            bool "2 MB"
#        config WM_CHIP_FLASH_SIZE_4MB
#            bool "4 MB"
#        config WM_CHIP_FLASH_SIZE_8MB
#            bool "8 MB"
#        config WM_CHIP_FLASH_SIZE_16MB
#            bool "16 MB"
#    endchoice

    choice WM_PARTITION_TABLE_TYPE
        prompt "Partition Table"
        default WM_PARTITION_TABLE_LARGE_APP if BUILD_TYPE_W800 || BUILD_TYPE_W801S || BUILD_TYPE_W803
        default WM_PARTITION_TABLE_NORMAL_APP if BUILD_TYPE_W806 || BUILD_TYPE_W805 || BUILD_TYPE_W802
        help
            The partition table determines where apps, data and other resources are expected to
            be found.

        config WM_PARTITION_TABLE_NORMAL_APP
            bool "Normal app, no OTA (components/partition_table/config/partition_table_normal.csv)"
            help
                This is the default partition table, with a 1MB app partition.

        if BUILD_TYPE_W800 || BUILD_TYPE_W801S || BUILD_TYPE_W802 || BUILD_TYPE_W803
            config WM_PARTITION_TABLE_LARGE_APP
                bool "Large app, no OTA (components/partition_table/config/partition_table_large.csv)"
                help
                    This is a variation of the default partition table, that expands
                    the 1MB app partition size to 1924KB to fit more code.
        endif

        config WM_PARTITION_TABLE_WITH_OTA
            bool "Normal app, with OTA (components/partition_table/config/partition_table_with_ota.csv)"
            help
                This is a basic OTA-enabled partition table.
                During a full-scale upgrade, the app and app_ota are allocated the same amount of space.
                For upgrades compressed with xz, the app_ota is allocated 60% of the space of the app.

        config WM_PARTITION_TABLE_CUSTOMIZATION
            bool "Custom partition table (<project directory>/partition_table_custom.csv)"
            help
                This is a custom partition table.

    endchoice

    config WM_PARTITION_TABLE_OFFSET
        hex
        default 0xE000
        help
            The address of partition table.Do not modify, otherwise the bootloader will not work.
            Internal use, any modification is not allowed.

endmenu
```

## components/posix/Kconfig
```kconfig
menuconfig COMPONENT_POSIX_ENABLED
    bool "Posix"
    default n
    help
        Select this option to enable posix and show the submenu.

config POSIX_TASK_NAME_DEFAULT
    depends on COMPONENT_POSIX_ENABLED
    string "Default name of pthreads"
    default "pthread"
    help
        The default name of pthreads.

#    config POSIX_TASK_PRIO_DEFAULT
#        depends on COMPONENT_POSIX_ENABLED
#        int "Default task priority"
#        range 0 15
#        default 1
#        help
#            Priority used to create new tasks with default pthread parameters.
#
#    config POSIX_TASK_STACK_MIN
#        depends on COMPONENT_POSIX_ENABLED
#        int "Minimum allowed pthread stack size"
#        default 256
#        help
#            Minimum allowed pthread stack size set in attributes passed to pthread_create

config POSIX_TIMER_NAME_DEFAULT
    depends on COMPONENT_POSIX_ENABLED
    string "Default name of timer"
    default "timer"
    help
        The default name of timer.

config POSIX_MQ_MAX_MESSAGES
    depends on COMPONENT_POSIX_ENABLED
    int "Default number of messages"
    range 1 256
    default 10
    help
        Maximum number of messages in an mq at one time.

config POSIX_MQ_MAX_SIZE
    depends on COMPONENT_POSIX_ENABLED
    int "Default size of messages"
    range 4 1024
    default 128
    help
        Maximum size (in bytes) of each message.
```

## components/websockets/Kconfig
```kconfig
menuconfig COMPONENT_WEBSOCKET_ENABLED
    bool "websocket"
    default n
    help
        Select this option to enable websocket.


    if COMPONENT_WEBSOCKET_ENABLED
        config WEBSOCKET_SECURITY
            bool "Websocket Security"
            default y
            help
                Websocket uses TLS as the transport layer.
    endif
```

## components/wm_atcmd/Kconfig
```kconfig
menuconfig COMPONENT_WM_ATCMD_ENABLED
    bool "AT Command"
    default n
    help
        Select this option to enable wm atcmd and show the submenu.

if COMPONENT_WM_ATCMD_ENABLED

    choice WM_ATCMD_UART_MODE
        prompt "AT Command port"
        default WM_ATCMD_USE_UART1
        help
            Select which uart port shall be used for AT Command.

        config WM_ATCMD_USE_UART0
            bool "Uart0"
            help
                Use uart0.

        config WM_ATCMD_USE_UART1
            bool "Uart1"
            help
                Use uart1.

        config WM_ATCMD_USE_UART2
            bool "Uart2"
            help
                Use uart2.

        config WM_ATCMD_USE_UART3
            bool "Uart3"
            help
                Use uart3.

        config WM_ATCMD_USE_UART4
            bool "Uart4"
            help
                Use uart4.

        if BUILD_TYPE_W801 || BUILD_TYPE_W801S || BUILD_TYPE_W802 || BUILD_TYPE_W806
            config WM_ATCMD_USE_UART5
                bool "Uart5"
                help
                    Use uart5.
        endif

    endchoice

    config WM_ATCMD_UART_PORT
        int
        default 0 if WM_ATCMD_USE_UART0
        default 1 if WM_ATCMD_USE_UART1
        default 2 if WM_ATCMD_USE_UART2
        default 3 if WM_ATCMD_USE_UART3
        default 4 if WM_ATCMD_USE_UART4
        default 5 if WM_ATCMD_USE_UART5
        help
            This option will be automatically assigned a specific value based on the selection of the "WM_ATCMD_USE_UARTx".
            Internal use, any modification is not allowed.

    config WM_ATCMD_UART_DEVICE
        string
        default "uart0" if WM_ATCMD_USE_UART0
        default "uart1" if WM_ATCMD_USE_UART1
        default "uart2" if WM_ATCMD_USE_UART2
        default "uart3" if WM_ATCMD_USE_UART3
        default "uart4" if WM_ATCMD_USE_UART4
        default "uart5" if WM_ATCMD_USE_UART5
        help
            This option will be automatically assigned a specific value based on the selection of the "WM_ATCMD_USE_UARTx".
            Internal use, any modification is not allowed.

    config WM_ATCMD_USAGE_ENABLE
        bool "Enable ATCMD USAGE"
        default y
        help
            Enable atcmd usage.

    config WM_ATCMD_SYS_ENABLE
        bool "Enable ATCMD SYS"
        default y
        help
            Enable atcmd system.

    if CHIP_HAVE_WIFI
        config WM_ATCMD_WIFI_ENABLE
            select COMPONENT_WIFI_ENABLED
            select WIFI_ENABLE_AP_FEATURE
            select COMPONENT_CJSON_ENABLED
            bool "Enable ATCMD Wi-Fi"
            default y
            help
                Enable atcmd Wi-Fi.

        config WM_ATCMD_TCP_ENABLE
            select WM_ATCMD_WIFI_ENABLE
            bool "Enable ATCMD TCP"
            default y
            help
                Enable atcmd tcp.

        config WM_ATCMD_MQTT_ENABLE
            select COMPONENT_MQTT_ENABLED
            bool "Enable ATCMD MQTT"
            default n
            help
                Enable atcmd mqtt.
                Internal use, any modification is not allowed

        config WM_ATCMD_HTTP_ENABLE
            select COMPONENT_HTTP_CLIENT_ENABLED
            bool "Enable ATCMD HTTP CLIENT"
            default y
            help
                Enable atcmd http.
    endif

    if CHIP_HAVE_BT
        config WM_ATCMD_BT_ENABLE
            select BT
            bool "Enable ATCMD BLUETOOTH"
            select COMPONENT_DRIVER_CRYPTO_ENABLED
            select COMPONENT_DRIVER_RNG_ENABLED
            default n
            help
                Enable atcmd bluetooth.
    endif

    if CHIP_HAVE_WIFI
        config WM_ATCMD_WEBNET_ENABLE
            select COMPONENT_WEBNET_ENABLED
            bool
            default n
            help
                Enable atcmd webnet.
                Internal use, any modificationis not allowed.

        config WM_ATCMD_OTA_ENABLE
            select COMPONENT_OTA_ENABLED
            select COMPONENT_OTA_HTTP_ENABLED
            bool "Enable ATCMD OTA"
            default n
            help
                Enable atcmd ota(over-the-air).
    endif

    menuconfig WM_ATCMD_FS_ENABLE
        select COMPONENT_FATFS_ENABLED
        select COMPONENT_DRIVER_RTC_ENABLED
        bool "Enable ATCMD FILE SYSTEM"
        default y
        help
            Enable atcmd for file system.

    if WM_ATCMD_FS_ENABLE
        choice ATCMD_FATFS_DISK_TYPE
            prompt "Select ATCMD FATFS disk type"
            default ATCMD_FATFS_SDMMC_DISK

            config ATCMD_FATFS_SDMMC_DISK
                select FATFS_SDMMC_DISK_ENABLE
                bool "SDMMC card"
                help
                    Use SDMMC card as FATFS disk.

            config ATCMD_FATFS_INTERNAL_FLASH_DISK
                select FATFS_INTERNAL_FLASH_DISK_ENABLE
                bool "Internal flash"
                help
                    Use internal flash as FATFS disk.

            config ATCMD_FATFS_EXTERNAL_FLASH_DISK
                select FATFS_EXTERNAL_FLASH_DISK_ENABLE
                bool "External flash"
                help
                    Use external flash as FATFS disk.
        endchoice
    endif

    config WM_ATCMD_PWM_ENABLE
        bool "Enable ATCMD PWM"
        default y
        select COMPONENT_DRIVER_PWM_ENABLED
        help
            Enable atcmd for pwm driver.

    config WM_ATCMD_I2C_ENABLE
        bool "Enable ATCMD I2C"
        default y
        select COMPONENT_DRIVER_I2C_ENABLED
        help
            Enable atcmd for i2c driver.

    config WM_ATCMD_SPIM_ENABLE
        bool "Enable ATCMD SPI MASTER"
        default y
        select COMPONENT_DRIVER_SPIM_ENABLED
        select COMPONENT_DRIVER_SPIM_SOFT_ENABLED
        help
            Enable atcmd for spi master driver.

    config WM_ATCMD_FT_ENABLE
        bool "Enable ATCMD FT"
        default n
        select COMPONENT_WIFI_ENABLED
        select COMPONENT_BT_ENABLED
        select COMPONENT_DRIVER_WDT_ENABLED
        help
            Enable FT atcmd for factory tools.

    orsource "lib/Kconfig"

endif
```

## components/wm_cli/Kconfig
```kconfig
menuconfig COMPONENT_CLI_ENABLED
    bool "CLI"
    default n
    select COMPONENT_EVENT_ENABLED
    help
        Select this option to enable cli and show the submenu.

if COMPONENT_CLI_ENABLED
    config CLI_LINE_SIZE
        int "Command line size (Byte)"
        range 16 256
        default 64
        help
            command line max size.

    config CLI_CMD_PARAS_NUM
        int "Maximum number of parameters"
        range 0 32
        default 8
        help
            The maximum number of parameters in the command.

    config CLI_CMD_HISTORY_NUM
        int "Numbers of history commands"
        range 1 10
        default 5
        help
            Command stores the most history commands (the maximum number here 
            refers to the maximum number of commands that can be stored. When 
            the history command line cache is full, it will automatically 
            release the earliest command record).

    config CLI_BOOT_BANNER
        bool
        default n
        help
            Show banner when boot cli.
            Internal use, any modification is not allowed.

    config CLI_ENABLE_LONG_USAGE
        bool "Enable long usage"
        default y
        help
            Select this option to enable long usage.

    choice CLI_UART_MODE
        prompt "CLI port"
        default CLI_USE_UART0
        help
            Select which uart port shall be used for CLI.

        config CLI_USE_UART0
            bool "Uart0"
            help
                Use uart0.

        config CLI_USE_UART1
            bool "Uart1"
            help
                Use uart1.

        config CLI_USE_UART2
            bool "Uart2"
            help
                Use uart2.

        config CLI_USE_UART3
            bool "Uart3"
            help
                Use uart3.

        config CLI_USE_UART4
            bool "Uart4"
            help
                Use uart4.

        if BUILD_TYPE_W801 || BUILD_TYPE_W801S || BUILD_TYPE_W802 || BUILD_TYPE_W806
            config CLI_USE_UART5
                bool "Uart5"
                help
                    Use uart5.
        endif

    endchoice

    config CLI_UART_PORT
        int
        default 0 if CLI_USE_UART0
        default 1 if CLI_USE_UART1
        default 2 if CLI_USE_UART2
        default 3 if CLI_USE_UART3
        default 4 if CLI_USE_UART4
        default 5 if CLI_USE_UART5
        help
            This option will be automatically assigned a specific value based on the selection of the "CLI_USE_UARTx".
            Internal use, any modification is not allowed.

    config CLI_UART_DEVICE
        string
        default "uart0" if CLI_USE_UART0
        default "uart1" if CLI_USE_UART1
        default "uart2" if CLI_USE_UART2
        default "uart3" if CLI_USE_UART3
        default "uart4" if CLI_USE_UART4
        default "uart5" if CLI_USE_UART5
        help
            This option will be automatically assigned a specific value based on the selection of the "CLI_USE_UARTx".
            Internal use, any modification is not allowed.

    orsource "commands/Kconfig"

endif
```
