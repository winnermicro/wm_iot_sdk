## components/bluetooth/Kconfig
```kconfig
# Bluetooth configuration options

# SPDX-License-Identifier: Apache-2.0

menuconfig COMPONENT_BT_ENABLED
	depends on CHIP_HAVE_BT
	bool "Bluetooth"
	select COMPONENT_RF_ENABLED
	select COMPONENT_NVS_ENABLED
	help
	This option enables Bluetooth support.

if COMPONENT_BT_ENABLED

	config BT_CTRL_VERSION
		int
		default 42 if BUILD_TYPE_W800 || BUILD_TYPE_W801 || BUILD_TYPE_W801S || BUILD_TYPE_W802 || BUILD_TYPE_W803
		default 50 if BUILD_TYPE_W900
		help
			Internal use, any modification is not allowed.
			
	config BT_DRIVER_QUIRK_NO_AUTO_DLE
		bool
		default y
		help
			Internal use, any modification is not allowed.		
		
	config BT_PERIPHERAL
		bool "Peripheral Role support"
		select BT_BROADCASTER
		select BT_CONN
		help
		  Select this for LE Peripheral role support.

	config BT_CENTRAL
		bool "Central Role support"
		select BT_OBSERVER
		select BT_CONN
		help
		  Select this for LE Central role support.

	config BT_BROADCASTER
		bool "Broadcaster Role support"
		help
		  Select this for LE Broadcaster role support.

	config BT_OBSERVER
		bool "Observer Role support"
		help
		  Select this for LE Observer role support.

	rsource "Kconfig.adv"

	config BT_CONN
		bool

	config BT_MAX_CONN
		int "Maximum number of simultaneous connections"
		depends on BT_CONN
		range 1 7
		default 2 if BT_MESH_GATT_CLIENT
		default 1
		help
		  Maximum number of simultaneous Bluetooth connections
		  supported.

	config BT_CONN_TX
		bool
		default BT_CONN || BT_ISO_BROADCASTER
		help
		  Hidden configuration that is true if ACL or broadcast ISO is enabled

	if BT_CONN
	config BT_HCI_ACL_FLOW_CONTROL
		bool "Controller to Host ACL flow control support"
		default y
		help
		  Enable support for throttling ACL buffers from the controller
		  to the host. This is particularly useful when the host and
		  controller are on separate cores since it ensures that we do
		  not run out of incoming ACL buffers.

	config BT_REMOTE_VERSION
		bool "Allow fetching of remote version"
		# Enable if building a Controller-only build
		default y if BT_HCI_RAW
		help
		  Enable this to get access to the remote version in the Controller and
		  in the Host through bt_conn_get_remote_info(). The fields in question
		  can then be found in the bt_conn_remote_info struct.

	config BT_PHY_UPDATE
		bool "PHY Update"
		default y
		depends on (BT_CTRL_VERSION >= 50) || BT_CTLR_PHY_UPDATE_SUPPORT
		help
		  Enable support for Bluetooth 5.0 PHY Update Procedure.

	config BT_DATA_LEN_UPDATE
		bool "Data Length Update"
		default y
		depends on (BT_CTRL_VERSION >= 42) || BT_CTLR_DATA_LEN_UPDATE_SUPPORT
		help
		  Enable support for Bluetooth v4.2 LE Data Length Update procedure.

	config BT_PER_ADV_SYNC_TRANSFER_RECEIVER
		bool "Periodic Advertising Sync Transfer receiver"
		depends on BT_PER_ADV_SYNC && ((BT_CTRL_VERSION >= 50) || BT_CTLR_SYNC_TRANSFER_RECEIVER_SUPPORT)

	config BT_PER_ADV_SYNC_TRANSFER_SENDER
		bool "Periodic Advertising Sync Transfer sender"
		depends on (BT_PER_ADV_SYNC || BT_PER_ADV) && ((BT_CTRL_VERSION >= 50) || BT_CTLR_SYNC_TRANSFER_SENDER_SUPPORT)

	endif # BT_CONN

	rsource "Kconfig.iso"
	rsource "common/Kconfig"
	rsource "tinycrypt/Kconfig"
	rsource "host/Kconfig"
	orsource "controller/Kconfig"
	rsource "shell/Kconfig"
	rsource "crypto/Kconfig"
	#rsource "lib/Kconfig"
	#rsource "settings/Kconfig"
	
	config SETTINGS_RUNTIME
	bool
	default y
	help
	  Enables runtime storage back-end.
	  Internal use, any modification is not allowed.
	  
	rsource "porting/Kconfig"
	
	choice BLUETOOTH_TX_POWER_LEVEL
		prompt "Bluetooth transmit power"
		default BT_TX_POWER_LEVEL2
		help
			Choose bluetooth transmit power level.

		config BT_TX_POWER_LEVEL1
			bool "1dBm"
			help
				Transmit power level with 1 dBm.

		config BT_TX_POWER_LEVEL2
			bool "4dBm"
			help
				Transmit power level with 4 dBm.

		config BT_TX_POWER_LEVEL3
			bool "7dBm"
			help
				Transmit power level with 7 dBm.

		config BT_TX_POWER_LEVEL4
			bool "10dBm"
			help
				Transmit power level with 10 dBm.

		config BT_TX_POWER_LEVEL5
			bool "13dBm"
			help
				Transmit power level with 13 dBm.
	endchoice

	config BT_TX_POWER_LEVEL_INDEX
            int
            default 1 if BT_TX_POWER_LEVEL1
            default 2 if BT_TX_POWER_LEVEL2
            default 3 if BT_TX_POWER_LEVEL3
            default 4 if BT_TX_POWER_LEVEL4
            default 5 if BT_TX_POWER_LEVEL5
            help
                This option will be automatically assigned a specific value based on the selection of the "BT_TX_POWER_LEVELx".
                Internal use, any modification is not allowed.
	config BT_PRINT_DEBUG_LEVEL
		depends on COMPONENT_LOG_ENABLED
		int "Print debug level, 0: nothing, 1: error, 2: warning, 3: information, 4: debug, 5: verbose"
		range 0 5
		default 3

	config BT_COMPANY_ID
		hex "Company Id"
		default 0x070C
		range 0x0000 0xFFFF
		help
		  Note that the controller is Company Identifier is
		  controlled by BT_CTLR_COMPANY_ID. The full list of Bluetooth
		  Company Identifiers can be found here:
		  https://www.bluetooth.com/specifications/assigned-numbers/company-identifiers

endif # COMPONENT_BT_ENABLED
```

## components/bluetooth/common/Kconfig
```kconfig
# Bluetooth common configuration options

# Copyright (c) 2017 Nordic Semiconductor ASA
# Copyright (c) 2016 Intel Corporation
# SPDX-License-Identifier: Apache-2.0

menu "Bluetooth buffer configuration"
	visible if (BT_CTRL_VERSION >= 42)

config BT_BUF_ACL_TX_SIZE
	int "Maximum supported ACL size for outgoing data"
	range 27 65535
	default 37 if BT_MESH_GATT
	default 27
	help
	  Maximum supported ACL size of data packets sent from the Host to the
	  Controller. This value does not include the HCI ACL header.
	  The Host will segment the data transmitted to the Controller so that
	  packets sent to the Controller will contain data up to this size.
	  In a combined build this value will be set in both the Host and the
	  Controller.
	  In a Host-only build the Host will read the maximum ACL size supported
	  by the Controller and use the smallest value supported by both the
	  Host and the Controller.
	  The Host supports sending of larger L2CAP PDUs than the ACL size and
	  will fragment L2CAP PDUs into ACL data packets.
	  The Controller will return this value in the HCI LE Read Buffer
	  Size command response. If this size if greater than effective Link
	  Layer transmission size then the Controller will perform
	  fragmentation before transmitting the packet(s) on air.
	  If this value is less than the effective Link Layer transmission size
	  then this will restrict the maximum Link Layer transmission size.

config BT_BUF_ACL_TX_COUNT
	int "Number of outgoing ACL data buffers"
	default 3
	range 1 255
	help
	  Number of outgoing ACL data buffers sent from the Host to the
	  Controller. This determines the maximum amount of data packets the
	  Host can have queued in the Controller before waiting for the
	  to notify the Host that more packets can be queued with the Number of
	  Completed Packets event.
	  The buffers are shared between all of the connections and the Host
	  determines how to divide the buffers between the connections.
	  The Controller will return this value in the HCI LE Read Buffer Size
	  command response.

config BT_BUF_ACL_RX_SIZE
	int "Maximum supported ACL size for incoming data"
	default 200 if BT_BREDR
	default 70 if BT_EATT
	default 69 if BT_SMP
	default 37 if BT_MESH_GATT
	default 27
	range 70 65535 if BT_EATT
	range 69 65535 if BT_SMP
	range 27 65535
	help
	  Maximum support ACL size of data packets sent from the Controller to
	  the Host. This value does not include the HCI ACL header.
	  In a combined Host and Controller build the buffer sizes in both the
	  Host and the Controller will use this value for buffer sizes, and
	  therefore Controller to Host flow Controller is not needed.
	  In a Host only build with Controller to Host flow control enabled
	  the Host will inform the Controller about the maximum ACL data size it
	  can send by setting this value in the Host Buffer Size command.
	  If Controller to Host flow control is not enabled then the Controller
	  can assume the Host has infinite buffer size so this value should then
	  be set to something that is guaranteed the Controller will not exceed
	  or the data packets will be dropped.
	  In a Controller only build this will determine the maximum ACL size
	  that the Controller will send to the Host.
	  The Host supports reassembling of L2CAP PDUs from ACL data packets,
	  but the maximum supported L2CAP PDU size is limited by the maximum
	  supported ACL size.
	  This means the maximum L2CAP PDU MTU is restricted by the maximum ACL
	  size subtracting the 4 byte header of an L2CAP PDU.
	  When using L2CAP Connection oriented Channels without segmentation
	  then the L2CAP SDU MTU is also restricted by the maximum ACL size
	  subtracting the 4 Byte header of an L2CAP PDU plus the 2 byte header
	  of an L2CAP SDU.

	  With Enhanced ATT enabled the minimum of 70 is needed to support the
	  minimum ATT_MTU of 64 octets in an L2CAP SDU without segmentation.
	  With SMP LE Secure Connections enabled the minimum of 69 is needed to
	  support the minimum SMP MTU of 65 octets (public key + opcode) in an
	  L2CAP PDU.

	  An L2CAP PDU is also referred to as an L2CAP basic frame or B-frame.
	  An L2CAP SDU is also referred to as an L2CAP Credit-based frame or
	  K-frame.

config BT_BUF_ACL_RX_COUNT
	int "Number of incoming ACL data buffers"
	#default NET_BUF_RX_COUNT if NET_L2_BT
	default 3 if BT_RECV_BLOCKING
	default 6
	range 1 64
	help
	  Number or incoming ACL data buffers sent from the Controller to the
	  Host.
	  In a combined Host and Controller build the buffers are shared and
	  therefore Controller to Host flow control is not needed.
	  In a Host only build with Controller to Host flow control enabled
	  the Host will inform the Controller about the maximum number of
	  buffers by setting this value in the Host Buffer Size command.
	  When Controller to Host flow control is not enabled the Controller
	  can assume that the Host has infinite amount of buffers.

config BT_BUF_EVT_RX_SIZE
	int "Maximum supported HCI Event buffer length"
	default 255 if (BT_EXT_ADV && BT_OBSERVER) || BT_PER_ADV_SYNC || BT_DF_CONNECTION_CTE_RX
	# LE Read Supported Commands command complete event.
	default 68
	range 68 255
	help
	  Maximum supported HCI event buffer size. This value does not include
	  the HCI Event header.
	  This value is used by both the Host and the Controller for buffer
	  sizes that include HCI events. It should be set according to the
	  expected HCI events that can be generated from the configuration.
	  If the subset of possible HCI events is unknown, this should be set to
	  the maximum of 255.

config BT_BUF_EVT_RX_COUNT
	int "Number of HCI Event buffers"
	default 3 if BT_RECV_BLOCKING
	default 20 if (BT_MESH && !(BT_BUF_EVT_DISCARDABLE_COUNT > 0))
	default 10
	range 2 255
	help
	  Number of buffers available for incoming HCI events from the
	  Controller.

config BT_BUF_EVT_DISCARDABLE_SIZE
	int "Maximum supported discardable HCI Event buffer length"
	range 43 255 if !BT_EXT_ADV
	range 58 255 if BT_EXT_ADV
	# LE Extended Advertising Report event
	default 255 if BT_BREDR
	# Le Advertising Report event
	default 43 if !BT_EXT_ADV
	default 58 if BT_EXT_ADV
	help
	  Maximum support discardable HCI event size of buffers in the separate
	  discardable event buffer pool. This value does not include the
	  HCI Event header.
	  The minimum size is set based on the Advertising Report. Setting
	  the buffer size different than BT_BUF_EVT_RX_SIZE can save memory.

config BT_BUF_EVT_DISCARDABLE_COUNT
	int "Number of discardable HCI Event buffers"
	range 1 255
	default 20 if BT_MESH
	default 3
	depends on (BT_CTRL_VERSION >= 42)
	help
	  Number of buffers in a separate buffer pool for events which
	  the HCI driver considers discardable. Examples of such events
	  could be e.g. Advertising Reports. The benefit of having such
	  a pool is that the if there is a heavy inflow of such events
	  it will not cause the allocation for other critical events to
	  block and may even eliminate deadlocks in some cases.

config BT_BUF_CMD_TX_SIZE
	int "Maximum support HCI Command buffer length"
	default 255 if (BT_EXT_ADV || BT_BREDR || BT_ISO_CENTRAL)
	# LE Set Connection CTE Receive Parameters. Value required to store max allowed number
	# of antenna ids for platforms other than Nordic.
	default 83 if (!BT_EXT_ADV && !BT_BREDR && BT_CTLR_DF && BT_CTLR_DF_CONN_CTE_REQ && !SOC_COMPATIBLE_NRF)
	# LE Generate DHKey v2 command
	default 65
	range 65 255
	help
	  Maximum data size for each HCI Command buffer. This value does not
	  include the HCI Command header.
	  This value is used by both the Host and the Controller for buffer
	  sizes that include HCI commands. It should be set according to the
	  expected HCI commands that can be sent from the configuration.
	  If the subset of possible HCI commands is unknown, this should be set
	  to the maximum of 255.

config BT_BUF_CMD_TX_COUNT
	int "Number of HCI command buffers"
	default 2
	range 2 64
	help
	  Number of buffers available for outgoing HCI commands from the Host.

endmenu

config BT_WAIT_NOP
	bool
	help
	  Emit a Command Complete event from the Controller (and wait for it
	  from the Host) for the NOP opcode to indicate that the Controller is
	  ready to receive commands.
	  Internal use, any modification is not allowed.
	  
config BT_RPA
	bool
	select TINYCRYPT
	select TINYCRYPT_AES

config BT_ASSERT
	bool
	default y
	help
	  Use a custom Bluetooth assert implementation instead of the
	  kernel-wide __ASSERT() when CONFIG_ASSERT is disabled.
	  Internal use, any modification is not allowed.
if BT_ASSERT

config BT_ASSERT_VERBOSE
	bool	
	default y
	help
	  When CONFIG_BT_ASSERT is enabled, this option turns on printing the
	  cause of the assert to the console using printk().
	  Internal use, any modification is not allowed.
	  
config BT_ASSERT_PANIC
	bool
	help
	  When CONFIG_BT_ASSERT is enabled, this option makes the code call
	  k_panic() instead of k_oops() when an assertion is triggered.
	  Internal use, any modification is not allowed.
	  
endif # BT_ASSERT
```

## components/bluetooth/porting/Kconfig
```kconfig
# Bluetooth LE stack configuration options

# Copyright (c) 2016-2020 Nordic Semiconductor ASA
# Copyright (c) 2015-2016 Intel Corporation
# SPDX-License-Identifier: Apache-2.0

config SYS_CLOCK_MAX_TIMEOUT_DAYS
	int
	range 0 366
	default 365
	help
	  Internal use, any modification is not allowed.
	  
config SYS_CLOCK_TICKS_PER_SEC
    int
	range 100 1000
	default FREERTOS_HZ
	help
	  Internal use, any modification is not allowed.  
```

## components/bluetooth/services/Kconfig
```kconfig
# GATT Services

# Copyright (c) 2018 Nordic Semiconductor ASA
# SPDX-License-Identifier: Apache-2.0

menu "GATT Services"
	depends on BT_CONN

rsource "Kconfig.dis"

rsource "Kconfig.bas"

rsource "Kconfig.hrs"

rsource "Kconfig.tps"

rsource "Kconfig.wps"

config BT_OTA
	bool "GATT OTA over BLE service"

rsource "ias/Kconfig.ias"

rsource "ots/Kconfig"

endmenu
```

## components/bluetooth/services/Kconfig.wps
```kconfig
# Bluetooth GATT Wi-Fi Provision service

# Copyright (c) 2024 WinnerMicro
# SPDX-License-Identifier: Apache-2.0

config BT_WPS
	bool "GATT Wi-Fi Provision service"
```

## components/bluetooth/shell/Kconfig
```kconfig
# Shell configuration options

# Copyright (c) 2017 Intel Corporation
# SPDX-License-Identifier: Apache-2.0

config BT_SHELL
	bool "Bluetooth shell"
	select COMPONENT_CLI_ENABLED
	help
	  Activate shell module that provides Bluetooth commands to the
	  console.
	  Internal use, any modification is not allowed.
```
