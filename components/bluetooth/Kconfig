## components/fatfs/Kconfig
```kconfig
menuconfig COMPONENT_FATFS_ENABLED
    bool "FATFS"
    default n
    help
        Select this option to enable FATFS and show the submenu.

if COMPONENT_FATFS_ENABLED

    menu "FATFS disk configuration"
        config FATFS_SDMMC_DISK_ENABLE
            select COMPONENT_DRIVER_SDMMC_ENABLED
            bool "Enable FATFS disk on SDMMC card"
            default n
            help
                Select this option to enable FATFS disk on SDMMC card.

        config FATFS_INTERNAL_FLASH_DISK_ENABLE
            bool "Enable FATFS disk on internal flash"
            default n
            help
                Select this option to enable FATFS disk on internal flash.

        config FATFS_EXTERNAL_FLASH_DISK_ENABLE
            bool "Enable FATFS disk on external flash"
            default n
            help
                Select this option to enable FATFS disk on external flash.
    endmenu

    config FATFS_FF_STR_VOLUME_ID_ENABLE
        bool "Enable volume ID string support"
        default n
        help
            Enable this option to support custom volume ID strings for each storage device.
            When enabled, you can specify arbitrary strings as volume IDs.
            When disabled, default numeric volume IDs will be used.

    menu "Volume ID string configuration"
        depends on FATFS_FF_STR_VOLUME_ID_ENABLE

        config FATFS_SDMMC_DISK_FF_VOLUME_STRS
            string "SDMMC disk volume ID"
            default "C"
            help
                Specify the volume ID string for the SDMMC disk.
                This string will be used to identify and mount the SDMMC disk volume.

        config FATFS_INTERNAL_FLASH_DISK_FF_VOLUME_STRS
            string "Internal flash volume ID"
            default "D"
            help
                Specify the volume ID string for the internal flash disk.
                This string will be used to identify and mount the internal flash disk volume.

        config FATFS_EXTERNAL_FLASH_DISK_FF_VOLUME_STRS
            string "External flash volume ID"
            default "E"
            help
                Specify the volume ID string for the external flash disk.
                This string will be used to identify and mount the external flash disk volume.
    endmenu

    if FATFS_INTERNAL_FLASH_DISK_ENABLE
        config FATFS_INTERNAL_FLASH_PARTITION_NAME
            string "Internal flash partition name"
            default "fatfs"
            help
                Specify the partition name for the internal flash FATFS disk.
                This name should match the partition name defined in the partition table.
    endif

    if FATFS_EXTERNAL_FLASH_DISK_ENABLE
        config FATFS_EXTERNAL_FLASH_DEVICE_NAME
            string "External flash device name"
            default "flash_w25q"
            help
                Specify the device name for the external flash FATFS disk.
                This name should match the external flash device name defined in the device table.
        config FATFS_EXTERNAL_FLASH_START_ADDRESS
            hex "External flash start address"
            default 0x0
            help
                Specify the start address for the external flash FATFS disk.
        config FATFS_EXTERNAL_FLASH_SIZE
            hex "External flash size for FATFS"
            default 0x100000
            help
                Specify the size of the area on external flash to be used for FATFS.
                This defines the maximum space available for the FATFS file system on the external flash.
    endif

    config FATFS_USE_FASTSEEK
        bool "Enable fast seek algorithm when using lseek function"
        default n
        help
            This option switches fast seek function.

    choice FATFS_CHOOSE_COD_EPAGE
        prompt "OEM Code Page"
        default FATFS_COD_EPAGE_437
        help
            OEM code page for file name encoding.

            This option specifies the OEM code page to be used on the target system.
            Incorrect code page setting can cause a file open failure.

            If "FATFS_COD_EPAGE_DYNAMIC" is selected, it will greatly increase the firmware size.

        config FATFS_COD_EPAGE_DYNAMIC
            bool "Dynamic (all code pages supported)"
        config FATFS_COD_EPAGE_437
            bool "US (CP437)"
        config FATFS_COD_EPAGE_720
            bool "Arabic (CP720)"
        config FATFS_COD_EPAGE_737
            bool "Greek (CP737)"
        config FATFS_COD_EPAGE_771
            bool "KBL (CP771)"
        config FATFS_COD_EPAGE_775
            bool "Baltic (CP775)"
        config FATFS_COD_EPAGE_850
            bool "Latin 1 (CP850)"
        config FATFS_COD_EPAGE_852
            bool "Latin 2 (CP852)"
        config FATFS_COD_EPAGE_855
            bool "Cyrillic (CP855)"
        config FATFS_COD_EPAGE_857
            bool "Turkish (CP857)"
        config FATFS_COD_EPAGE_860
            bool "Portugese (CP860)"
        config FATFS_COD_EPAGE_861
            bool "Icelandic (CP861)"
        config FATFS_COD_EPAGE_862
            bool "Hebrew (CP862)"
        config FATFS_COD_EPAGE_863
            bool "Canadian French (CP863)"
        config FATFS_COD_EPAGE_864
            bool "Arabic (CP864)"
        config FATFS_COD_EPAGE_865
            bool "Nordic (CP865)"
        config FATFS_COD_EPAGE_866
            bool "Russian (CP866)"
        config FATFS_COD_EPAGE_869
            bool "Greek 2 (CP869)"
        config FATFS_COD_EPAGE_932
            bool "Japanese (DBCS) (CP932)"
        config FATFS_COD_EPAGE_936
            bool "Simplified Chinese (DBCS) (CP936)"
        config FATFS_COD_EPAGE_949
            bool "Korean (DBCS) (CP949)"
        config FATFS_COD_EPAGE_950
            bool "Traditional Chinese (DBCS) (CP950)"

    endchoice
    config FATFS_COD_EPAGE
        int
        default 0 if FATFS_COD_EPAGE_DYNAMIC
        default 437 if FATFS_COD_EPAGE_437
        default 720 if FATFS_COD_EPAGE_720
        default 737 if FATFS_COD_EPAGE_737
        default 771 if FATFS_COD_EPAGE_771
        default 775 if FATFS_COD_EPAGE_775
        default 850 if FATFS_COD_EPAGE_850
        default 852 if FATFS_COD_EPAGE_852
        default 855 if FATFS_COD_EPAGE_855
        default 857 if FATFS_COD_EPAGE_857
        default 860 if FATFS_COD_EPAGE_860
        default 861 if FATFS_COD_EPAGE_861
        default 862 if FATFS_COD_EPAGE_862
        default 863 if FATFS_COD_EPAGE_863
        default 864 if FATFS_COD_EPAGE_864
        default 865 if FATFS_COD_EPAGE_865
        default 866 if FATFS_COD_EPAGE_866
        default 869 if FATFS_COD_EPAGE_869
        default 932 if FATFS_COD_EPAGE_932
        default 936 if FATFS_COD_EPAGE_936
        default 949 if FATFS_COD_EPAGE_949
        default 950 if FATFS_COD_EPAGE_950
        default 437
        help
            Internal use, any modification is not allowed.

    menu "File name length configuration"
        choice FATFS_LONG_FILENAMES
            prompt "Long file name support"
            default FATFS_LFN_NONE
            help
                The "FATFS_LONG_FILENAMES" choices the support for LFN (long file name).

            config FATFS_LFN_NONE
                bool "No long file name"
            config FATFS_LFN_HEAP
                bool "Long file name buffer in heap"
            config FATFS_LFN_STACK
                bool "Long file name buffer on the stack"
        endchoice

        config FATFS_MAX_LFN
            int "Maximum length of long file name"
            depends on !FATFS_LFN_NONE
            default 128
            range 12 255
            help
                The maximum length of a file name, configuring a smaller maximum file name length can reduce resource consumption.
    endmenu

    choice FATFS_API_ENCODING
        prompt "API character encoding"
        depends on !FATFS_LFN_NONE
        default CONFIG_FATFS_LFN_UNICODE_ANSI_OEM
        help
            This option choices the character encoding on the API when LFN is enabled.

        config CONFIG_FATFS_LFN_UNICODE_ANSI_OEM
            bool "ANSI/OEM"
        config CONFIG_FATFS_LFN_UNICODE_UTF_8
            bool "UTF-8"
    endchoice

    config FATFS_FS_LOCK
        int "The number of files opened simultaneously while protected by the locking function"
        default 0
        range 0 65535
        help
            The option FF_FS_LOCK switches file lock function to control duplicated file open 
            and illegal operation to open objects. This option must be 0 when FF_FS_READONLY is 1.
            0:  Disable file lock function. To avoid volume corruption, application program
                should avoid illegal open, remove and rename to the open objects.
            >0: Enable file lock function. The value defines how many files/sub-directories
                can be opened simultaneously under file lock control. Note that the file
                lock control is independent of re-entrancy.

endif
```

## components/freertos/Kconfig
```kconfig
menu "FreeRTOS"

    config FREERTOS_HZ
        int "Tick rate (Hz)"
        range 100 1000
        default 1000
        help
            Select the tick rate at which FreeRTOS does pre-emptive context switching.

    config FREERTOS_IDLE_TASK_STACKSIZE
        int "Idle Task stack size (Word)"
        range 64 8192
        default 256
        help
            The idle task has its own stack, sized in word. The default size is enough for most uses.

            The stack size may need to be increased above the default if the app installs idle or thread local storage
            cleanup hooks that use a lot of stack memory.

    config FREERTOS_MAX_TASK_NAME_LEN
        int "Maximum task name length (Byte)"
        range 1 32
        default 16
        help
            Changes the maximum task name length. Each task allocated will
            include this many bytes for a task name. Using a shorter value
            saves a small amount of RAM, a longer value allows more complex
            names.

    menuconfig FREERTOS_USE_TRACE_FACILITY
        bool "Enable FreeRTOS trace facility"
        default y
        help
            If enabled, configUSE_TRACE_FACILITY will be defined as 1 in FreeRTOS.
            This will allow the usage of trace facility functions such as
            uxTaskGetSystemState().

    menuconfig FREERTOS_USE_STATS_FORMATTING_FUNCTIONS
        bool "Enable FreeRTOS stats formatting functions"
        depends on FREERTOS_USE_TRACE_FACILITY
        default y
        help
            If enabled, configUSE_STATS_FORMATTING_FUNCTIONS will be defined as 1 in
            FreeRTOS. This will allow the usage of stats formatting functions such
            as vTaskList().

    config FREERTOS_ENABLE_RUN_TIME_STATS
        bool "Enable FreeRTOS Run Time Stats"
        depends on FREERTOS_USE_STATS_FORMATTING_FUNCTIONS
        default n
        help
            If enabled, thread runtime will be counted.

    config FREERTOS_ENABLE_IDLE_HOOK
        bool "Enable FreeRTOS idle hook"
        default y
        help
            FreeRTOS can called vApplicationIdleHook when idle task execution.

    config FREERTOS_ENABLE_TICK_HOOK
        bool "Enable FreeRTOS tick hook"
        default n
        help
            FreeRTOS can called vApplicationTickHook.

    config FREERTOS_QUEUE_REGISTRY_SIZE
            int "FreeRTOS queue registry size (Number of items)"
            range 0 20
            default 0
            help
                FreeRTOS uses the queue registry as a means for kernel aware debuggers to locate queues, semaphores,
                and mutexes. The registry allows for a textual name to be associated with a queue for easy identification
                within a debugging GUI. A value of 0 will disable queue registry functionality, and a value larger than 0
                will specify the number of queues/semaphores/mutexes that the registry can hold.

    config FREERTOS_TIMER_TASK_PRIORITY
        int "FreeRTOS timer task priority"
        range 1 15
        default 15
        help
            The timer service task (primarily) makes use of existing FreeRTOS features, allowing timer
            functionality to be added to an application with minimal impact on the size of the application's
            executable binary.

            Use this constant to define the priority that the timer task will run at.

    config FREERTOS_TIMER_TASK_STACK_DEPTH
        int "FreeRTOS timer task stack size (Word)"
        range 128 8192
        default 512
        help
            The timer service task (primarily) makes use of existing FreeRTOS features, allowing timer
            functionality to be added to an application with minimal impact on the size of the application's
            executable binary.

            Use this constant to define the size (in bytes) of the stack allocated for the timer task.

    config FREERTOS_TIMER_QUEUE_LENGTH
        int "FreeRTOS timer queue length (Number of items)"
        range 64 256
        default 128
        help
            FreeRTOS provides a set of timer related API functions. Many of these functions use a standard
            FreeRTOS queue to send commands to the timer service task. The queue used for this purpose is
            called the 'timer command queue'. The 'timer command queue' is private to the FreeRTOS timer
            implementation, and cannot be accessed directly.

            For most uses the default value of 10 is OK.

    config FREERTOS_ENABLE_STATIC_TASK_CLEAN_UP
        bool "Enable static task clean up hook"
        default y
        help
            Enable this option to make FreeRTOS call the static task clean up hook when a task is deleted.

    choice FREERTOS_ASSERT
        prompt "FreeRTOS assertions"
        default FREERTOS_ASSERT_FAIL_ABORT
        help
            Failed FreeRTOS configASSERT() assertions can be configured to
            behave in different ways.

            By default these behave the same as the global project assert settings.

        config FREERTOS_ASSERT_DISABLE
            bool "Disable"
            help
                FreeRTOS configASSERT() will not be compiled into the binary.

        config FREERTOS_ASSERT_FAIL_ABORT
            bool "Abort"
            help
                If a FreeRTOS configASSERT() fails, FreeRTOS will abort and
                halt execution.

        config FREERTOS_ASSERT_FAIL_PRINT_CONTINUE
            bool "Print and continue"
            help
                If a FreeRTOS assertion fails, print it out and continue.

    endchoice

    config FREERTOS_CHECK_STACKOVERFLOW
        bool "Check for stack overflow"
        default y
        help
            FreeRTOS can check for stack overflows in threads
            called vApplicationStackOverflowHook when this happens.

endmenu
```
