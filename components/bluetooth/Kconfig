## components/bluetooth/tinycrypt/Kconfig
```kconfig
# Bluetooth LE stack configuration options

# Copyright (c) 2016-2020 Nordic Semiconductor ASA
# Copyright (c) 2015-2016 Intel Corporation
# SPDX-License-Identifier: Apache-2.0
menu "Bluetooth tinycrypt configuration"
	visible if (BT_CTRL_VERSION >= 50)

config TINYCRYPT_ECC_DH
	bool "ecc dh select"
	default n
config TINYCRYPT_ECC_DSA
	bool "ecc dsa select"
	default n
config TINYCRYPT_AES
	bool "aes select"
	default n	
config TINYCRYPT_AES_CBC
	bool "aes cbc select"
	default n		
config TINYCRYPT_AES_CTR
	bool "aes ctr select"
	default n		
config TINYCRYPT_AES_CCM
	bool "aes ccm select"
	default n		
config TINYCRYPT_AES_CMAC
	bool "aes cmac select"
	default n		
config TINYCRYPT_SHA256
	bool "sha256 select"
	default n		
config TINYCRYPT_SHA256_HMAC
	bool "sha256 hmac select"
	default n	
config TINYCRYPT_SHA256_HMAC_PRNG
	bool "sha256 hmac prng select"
	default n	
config TINYCRYPT_CTR_PRNG
	bool "prng select"
	default n		
endmenu
```

## components/bootloader/Kconfig
```kconfig
menu "Bootloader"

    choice BOOTLOADER_LOG_LEVEL
        prompt "Bootloader log level"
        default BOOTLOADER_LOG_LEVEL_INFO
        help
            Setting bootloader output log level.

        config BOOTLOADER_LOG_LEVEL_NONE
            bool "No output"
            help
                Not output any logs.
        config BOOTLOADER_LOG_LEVEL_ERROR
            bool "Error"
            help
                Records errors that occur within the bootloader, which may impact its functionality.
                Only includes 'Error' log levels if this option be choice.
        config BOOTLOADER_LOG_LEVEL_WARN
            bool "Warn"
            help
                Indicates potential issues that may not cause errors but could affect the performance of the bootloader.
                Includes 'Warn', and 'Error' log levels if this option be choice.
        config BOOTLOADER_LOG_LEVEL_INFO
            bool "Info"
            help
                Conveys general information about bootloader operations, used to track the normal running of the bootloader.
                Includes 'Info', 'Warn', and 'Error' log levels if this option be choice.
        config BOOTLOADER_LOG_LEVEL_DEBUG
            bool "Debug"
            help
                In-depth information for issue diagnosis, essential for development and troubleshooting.
                Includes 'Debug', 'Info', 'Warn', and 'Error' log levels if this option be choice
        config BOOTLOADER_LOG_LEVEL_VERBOSE
            bool "Verbose"
            help
                Provides detailed information, typically used for development to trace the execution of bootloader.
                Includes All log levels if this option be choice. Not recommended for production use.
    endchoice

    config BOOTLOADER_LOG_LEVEL
        int
        default 0 if BOOTLOADER_LOG_LEVEL_NONE
        default 1 if BOOTLOADER_LOG_LEVEL_ERROR
        default 2 if BOOTLOADER_LOG_LEVEL_WARN
        default 3 if BOOTLOADER_LOG_LEVEL_INFO
        default 4 if BOOTLOADER_LOG_LEVEL_DEBUG
        default 5 if BOOTLOADER_LOG_LEVEL_VERBOSE
        help
            This option will be automatically assigned a specific value based on the selection of the "BOOTLOADER_LOG_LEVEL_XX".

    config BOOTLOADER_SKIP_ESC_CHECK
        bool "Skip ESC check"
        default n
        help
            Skip ESC check during boot to speed up boot time (saves ~68ms).
            Note: If unable to flash program when pressing reset button, pull down the boot pin while holding the reset button

    config BOOTLOADER_SKIP_UPGRADE_CHECK
        bool "Skip upgrade check"
        default n
        help
            Skip firmware upgrade check during boot to speed up boot time (saves ~60ms).
            Note: If unable to flash program when pressing reset button, pull down the boot pin while holding the reset button

    config BOOTLOADER_SKIP_FIRMWARE_INTEGRITY_CHECK
        bool "Skip firmware integrity check"
        default n
        help
            Skip firmware integrity check during boot. This will slightly speed up boot time but
            disable firmware integrity verification.
            Note: If unable to flash program when pressing reset button, pull down the boot pin while holding the reset button

endmenu
```

## components/cjson/Kconfig
```kconfig
menuconfig COMPONENT_CJSON_ENABLED
    bool "cJSON"
    default n
    help
        Select this option to enable cJSON.
```

## components/cloud/Kconfig
```kconfig
menu "Cloud"

    config COMPONENT_AWS_ENABLED
        bool "Enable AWS"
        default n
        help
            Select this option to enable AWS.

    if COMPONENT_AWS_ENABLED
        orsource "aws/Kconfig"
    endif

endmenu
```

## components/cloud/aws/Kconfig
```kconfig
menu "AWS"

    config AWS_CORE_MQTT
        bool "Using coreMQTT"
        default n
        help
            Select this option to enable coreMQTT.

    config AWS_CORE_HTTP
        bool "Using coreHTTP"
        select COMPONENT_HTTP_CLIENT_ENABLED
        select WM_HTTP2_CLIENT_ENABLED
        select WM_HTTP2_CLIENT_LLHTTP
        default n
        help
            Select this option to enable coreHTTP.

    config AWS_CORE_JSON
        bool "Using coreJSON"
        default n
        help
            Select this option to enable coreJSON.

    config AWS_DEVICE_SHADOW
        bool "Using device shadow"
        select AWS_CORE_JSON
        select AWS_CORE_MQTT
        default n
        help
            Select this option to enable device shadow.

    config AWS_JOB
        bool "Using job for aws"
        select AWS_CORE_JSON
        select AWS_CORE_MQTT
        default n
        help
            Select this option to enable job for aws.

    config AWS_OTA
        bool "Using OTA for aws"
        select AWS_JOB
        default n
        help
            Select this option to enable OTA for aws.

endmenu
```

## components/coap/Kconfig
```kconfig
menuconfig COMPONENT_COAP_ENABLED
    depends on CHIP_HAVE_WIFI
    bool "CoAP"
    default n
    select COMPONENT_LWIP_ENABLED
    help
        Select this option to enable Coap and show the submenu.

if COMPONENT_COAP_ENABLED
        choice COAP_DEBUGGING_LEVEL
            prompt "Set CoAP debugging level"
            default COAP_LOG_NONE
            help
                Choice CoAP debugging functions at compile time for the example code.

                If this option isn't none, call coap_set_log_level()
                at runtime in order to enable CoAP debug output via the WM
                log mechanism.

                Note: The Mbed TLS library logging is controlled by the mbedTLS
                configuration, but logging level mbedTLS must be set for CoAP
                to log it.

        config COAP_LOG_NONE
            bool "No output"
            help
                Don't output log.
        config COAP_LOG_ERROR
            bool "Error"
            help
                Output error level log.
        config COAP_LOG_WARN
            bool "Warn"
            help
                Output log above warning level.
        config COAP_LOG_INFO
            bool "Info"
            help
                Output log above info level.
        config COAP_LOG_DEBUG
            bool "Debug"
            help
                Output log above debug level.
        config COAP_LOG_VERBOSE
            bool "Verbose"
            help
                Output log above verbose level.

        endchoice

        config COAP_LOG_DEFAULT_LEVEL
            int
            default 0 if COAP_LOG_NONE
            default 3 if COAP_LOG_ERROR
            default 4 if COAP_LOG_WARN
            default 7 if COAP_LOG_DEBUG
            default 8 if COAP_LOG_VERBOSE
            help
                This option will be automatically assigned a specific value based on the selection of the "COAP_DEBUGGING_LEVEL".
                Internal use, any modification is not allowed.

    config COAP_TCP_SUPPORT
        bool "Enable TCP within CoAP"
        default y
        help
            Enable TCP functionality for CoAP. This is required if TLS sessions
            are to be used.

            If this option is disabled, redundant CoAP TCP code is removed.

    config COAP_OSCORE_SUPPORT
        bool "Enable OSCORE support within CoAP"
        default n
        help
            Enable OSCORE (Object Security for Constrained RESTful Environments) functionality for CoAP.

            If this option is disabled, redundant CoAP OSCORE code is removed.

    config COAP_OBSERVE_PERSIST
        bool "Enable Server Observe Persist support within CoAP"
        default n
        help
            Enable Server Observe Persist support for CoAP.

            If this option is disabled, redundant CoAP Observe Persist code is removed.

    config COAP_WEBSOCKETS
        bool "Enable WebSockets support within CoAP"
        default n
        help
            Enable WebSockets support for CoAP.

            If this option is disabled, redundant CoAP WebSocket code is removed.

    config COAP_CLIENT_SUPPORT
        bool "Enable Client functionality within CoAP"
        default n
        help
            Enable client functionality (ability to make requests and receive
            responses) for CoAP. If the server is going to act as a proxy, then
            this needs to be enabled to support the ongoing session going to
            the next hop.

            If this option is disabled, redundant CoAP client only code is removed.
            If both this option and COAP_SERVER_SUPPORT are disabled, then both
            are automatically enabled for backwards compatability.

    config COAP_SERVER_SUPPORT
        bool "Enable Server functionality within CoAP"
        default n
        help
            Enable server functionality (ability to receive requests and send
            responses) for CoAP.

            If this option is disabled, redundant CoAP server only code is removed.
            If both this option and COAP_CLIENT_SUPPORT are disabled, then both
            are automatically enabled for backwards compatability.
endif
```

## components/driver/Kconfig
```kconfig
menu "PERIPHERALS"

    config COMPONENT_DRIVER_RCC_ENABLED
        bool "RCC"
        default y
        help
            Enable rcc driver module.
            Internal use, any modificationis not allowed.

    config COMPONENT_DRIVER_PMU_ENABLED
        bool "PMU"
        default y
        help
            Enable pmu driver module.
            Internal use, any modificationis not allowed.

    config COMPONENT_DRIVER_IRQ_ENABLED
        bool "IRQ"
        default y
        help
            Enable irq driver module.
            Internal use, any modificationis not allowed.

    config COMPONENT_DRIVER_DMA_ENABLED
        bool "DMA"
        default y
        help
            Enable dma driver module.
            Internal use, any modificationis not allowed.

    config COMPONENT_DRIVER_INTERNAL_FLASH_ENABLED
        bool "Internal FLASH"
        default y
        help
            Enable internal flash driver module.
            Internal use, any modification is not allowed.


    config COMPONENT_DRIVER_EXTERNAL_FLASH_ENABLED
        bool "External FLASH"
        select COMPONENT_DRIVER_SPIM_ENABLED
        default n
        help
            Enable external flash driver module.

    config COMPONENT_DRIVER_TIMER_ENABLED
        bool "Timer"
        default n
        help
            Enable timer driver module.

    config COMPONENT_DRIVER_UART_ENABLED
        bool "UART"
        default y
        help
            Enable uart driver module.

    config COMPONENT_DRIVER_GPIO_ENABLED
        bool "GPIO"
        default y
        help
            Enable gpio driver module.

    config COMPONENT_DRIVER_PSRAM_ENABLED
        bool "PSRAM"
        default n
        help
            Enable psram driver module.

    config COMPONENT_DRIVER_PWM_ENABLED
        bool "PWM"
        default n
        help
            Enable pwm driver module.

    config COMPONENT_DRIVER_RTC_ENABLED
        bool "RTC"
        default y
        help
            Enable rtc driver module.

    config COMPONENT_DRIVER_SDMMC_ENABLED
        bool "SDIO Host (SDMMC)"
        default n
        help
            Enable sdio host sdmmc driver module.

    config COMPONENT_DRIVER_SDSPI_ENABLED
        bool "SDIO Host (SPI Mode)"
        default n
        help
            Enable sdio host (SPI mode) driver module.

    config COMPONENT_DRIVER_SPIM_ENABLED
        bool "SPI Master"
        default n
        help
            Enable spi master driver module.

    config COMPONENT_DRIVER_WDT_ENABLED
        bool "WATCH Dog"
        default y
        help
            Enable watch dog driver module.

    config COMPONENT_DRIVER_TFT_LCD_ENABLED
        bool "TFT LCD"
        default n
        help
            Enable tft lcd driver module.

    choice COMPONENT_DRIVER_TFT_LCD_OPTIONS
        prompt "LCD Device"
        depends on COMPONENT_DRIVER_TFT_LCD_ENABLED
        help
            "select an option for tft lcd device"
   
        config COMPONENT_DRIVER_LCD_NV3041A_SPI
            bool "nv3041a_spi"
            help
                "LCD Device NV3041A_SPI"

        config COMPONENT_DRIVER_LCD_ST7735_SPI
            bool "st7735_spi"
            help
                "LCD Device ST7735_SPI"

        config COMPONENT_DRIVER_LCD_GZ035_SPI
            bool "gz035_spi"
            help
                "LCD Device GZ035_SPI"
    endchoice

    config COMPONENT_DRIVER_ADC_ENABLED
        bool "ADC"
        default n
        help
            Enable adc driver module.

    config COMPONENT_DRIVER_CRC_ENABLED
        bool "CRC"
        default n
        help
            Enable crc driver module.

    config COMPONENT_DRIVER_CRYPTO_ENABLED
        bool "CRYPTO"
        default n
        select COMPONENT_MBEDTLS_ENABLED
        help
            Enable hardware crypto engine driver module.

    config COMPONENT_DRIVER_HASH_ENABLED
        bool "HASH"
        default n
        help
            Enable hardware hash driver module.

    config COMPONENT_DRIVER_RNG_ENABLED
        bool "RNG"
        default y
        help
            Enable hardware rng driver module.

    config COMPONENT_DRIVER_RSA_ENABLED
        bool "RSA"
        default n
        help
            Enable hardware rsa driver module.

    if BUILD_TYPE_W801S || BUILD_TYPE_W806
    config COMPONENT_DRIVER_SEG_LCD_ENABLED
        bool "SEG LCD"
        default n
        help
            Enable seg lcd driver module.
    endif

    if BUILD_TYPE_W801S || BUILD_TYPE_W802 || BUILD_TYPE_W803 || BUILD_TYPE_W806
    config COMPONENT_DRIVER_TOUCH_SENSOR_ENABLED
        bool "Touch Sensor"
        default n
        help
            Enable touch sensor driver module.
    endif

    config COMPONENT_DRIVER_I2S_ENABLED
        bool "I2S"
        default n
        help
            Enable i2s driver module.

    config COMPONENT_DRIVER_I2C_ENABLED
        bool "I2C"
        default n
        help
            Enable i2c driver module.

    config COMPONENT_DRIVER_CODEC_ES8374_ENABLED
        bool "CODEC ES8374"
        default n
        select COMPONENT_DRIVER_I2S_ENABLED
        select COMPONENT_DRIVER_I2C_ENABLED
        help
            Enable codec es8374 driver module.

    config COMPONENT_DRIVER_SDIO_SLAVE_ENABLED
        bool "SDIO Slave"
        default n
        help
            Enable sdio slave driver module.

endmenu
```
