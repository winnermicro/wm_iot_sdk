## components/wm_ota/Kconfig
```kconfig
menuconfig COMPONENT_OTA_ENABLED
    bool "OTA"
    default n
    help
        Select this option to enable ota and show the submenu.

if COMPONENT_OTA_ENABLED

    config COMPONENT_OTA_HTTP_ENABLED
        depends on CHIP_HAVE_WIFI
        bool "Enable OTA_HTTP"
        default n
        select COMPONENT_HTTP_CLIENT_ENABLED
        help
            Select this option to enable ota with http client, and the "COMPONENT_HTTP_CLIENT_ENABLED" will also be set to 'y'

    config OTA_BLOCK_SIZE
        int "OTA block size"
        default 4096
        range 64 65536
        help
            Size of each block (in bytes) during OTA firmware download. The firmware is divided into multiple blocks for transmission.

    config OTA_RETRY_TIMEOUT
        int "OTA retry timeout"
        default 120000
        range 60000 3600000
        help
            Maximum time (in ms) for OTA to retry when network timeout occurs, OTA will keep retrying until upgrade completes or this timeout is reached.
            For non-network timeout errors, OTA will fail directly without retrying.

    config OTA_SOCKET_RECONNECT_TIMES
        int "ota socket reconnect times"
        default 5
        range 0 65535
        help
            The number of times socket connection failed and reconnected.

endif
```

## components/wm_pm/Kconfig
```kconfig
menu "Power Manager"

    config COMPONENT_PM_ENABLED
        bool "Enable power management"
        default n
        select FREERTOS_USE_TICKLESS_IDLE
        select COMPONENT_DRIVER_TIMER_ENABLED

    if COMPONENT_PM_ENABLED
            choice PM_WAKEUP_TIMER
            prompt "wake-up timer"
            default PM_WAKEUP_TIMER5
            help
                Choose which timed wakeup to use.

            config PM_WAKEUP_TIMER0
                bool "Timer0"
                help
                    Use timer0.

            config PM_WAKEUP_TIMER1
                bool "Timer1"
                help
                    Use timer1.

            config PM_WAKEUP_TIMER2
                bool "Timer2"
                help
                    Use timer2.

            config PM_WAKEUP_TIMER3
                bool "Timer3"
                help
                    Use timer3.

            config PM_WAKEUP_TIMER4
                bool "Timer4"
                help
                    Use timer4.

            config PM_WAKEUP_TIMER5
                bool "Timer5"
                help
                    Use timer5.
        endchoice

        config PM_WAKEUP_TIMER_INDEX
            int
            default 0 if PM_WAKEUP_TIMER0
            default 1 if PM_WAKEUP_TIMER1
            default 2 if PM_WAKEUP_TIMER2
            default 3 if PM_WAKEUP_TIMER3
            default 4 if PM_WAKEUP_TIMER4
            default 5 if PM_WAKEUP_TIMER5
            help
                This option will be automatically assigned a specific value based on the selection of the "PM_WAKEUP_TIMERx".
                Internal use, any modification is not allowed.

        config PM_WAKEUP_TIMER_DEVICE
            string
            default "timer0" if PM_WAKEUP_TIMER0
            default "timer1" if PM_WAKEUP_TIMER1
            default "timer2" if PM_WAKEUP_TIMER2
            default "timer3" if PM_WAKEUP_TIMER3
            default "timer4" if PM_WAKEUP_TIMER4
            default "timer5" if PM_WAKEUP_TIMER5
            help
                This option will be automatically assigned a specific value based on the selection of the "PM_WAKEUP_TIMERx".
                Internal use, any modification is not allowed.
    endif

endmenu
```

## components/wm_rf/Kconfig
```kconfig
if CHIP_HAVE_RF

    config COMPONENT_RF_ENABLED
        bool
        default y
        help
            Select chip rf function.
            Internal use, any modification is not allowed.

endif

if COMPONENT_RF_ENABLED

    if BUILD_TYPE_W800
        orsource "src/w800/Kconfig"
    endif

    if BUILD_TYPE_W801
        orsource "src/w800/Kconfig"
    endif

    if BUILD_TYPE_W801S
        orsource "src/w800/Kconfig"
    endif

    if BUILD_TYPE_W802
        orsource "src/w800/Kconfig"
    endif


    if BUILD_TYPE_W803
        orsource "src/w800/Kconfig"
    endif

    if BUILD_TYPE_W805
        orsource "src/w800/Kconfig"
    endif

    if BUILD_TYPE_W806
        orsource "src/w800/Kconfig"
    endif

endif
```

## components/wm_soc/w80x/Kconfig
```kconfig
menu "XT804"
    visible if CHIP_W80X

    if CHIP_W80X
        config FLASH_BASE_ADDR
            hex
            default 0x8000000
            help
                Internal use, any modification is not allowed.

        config SRAM_BASE_ADDR
            hex
            default 0x20000000
            help
                Internal use, any modification is not allowed.

        config SRAM_LENGTH
            hex
            default 0x28000
            help
                Internal use, any modification is not allowed.

        config DRAM_BASE_ADDR
            hex
            default 0x20028000
            help
                Internal use, any modification is not allowed.

        config DRAM_LENGTH
            hex
            default 0x20000
            help
                Internal use, any modification is not allowed.

        config PSRAM_BASE_ADDR
            hex
            default 0x30000000
            help
                Internal use, any modification is not allowed.

        config PSRAM_MAX_LENGTH
            hex
            default 0x800000
            help
                Internal use, any modification is not allowed.

        config UART_BASE_ADDR
            hex
            default 0x40010600
            help
                Internal use, any modification is not allowed.

        config UART_LENGTH
            hex
            default 0xA00
            help
                Internal use, any modification is not allowed.

        config XT804_SEPARATE_IRQ_SP
            bool
            default y
            help
                Use separate interrupt request stack pointer if enable.
                Internal use, any modification is not allowed.

        config XT804_ARCH_INTERRUPTSTACK
            int "Interrupt request stack size (Byte)"
            range 1024 16384
            default 4096
            help
                Interrupt request stack size.

        config XT804_IRQ_VECTOR_SIZE
            int
            range 256 256
            default 256
            help
                Interrupt request vector size.
                Internal use, any modification is not allowed.

        config XT804_SAVE_VR_REGISTERS
            bool "Enable vr registers save"
            default y
            help
                Enable vr registers save in the rtos.

        config XT804_SAVE_HIGH_REGISTERS
            bool "Enable high registers save"
            default y
            help
                Enable high registers save in the rtos.

        config XT804_SYSTEM_SECURE
            bool
            default y
            help
                Enable interrupt request secure when enable interrupt request.
                Internal use, any modification is not allowed.

        config XT804_TRAP_PRINT_STR
            bool "Enable exception interrupt string"
            default y
            help
                Use exceptions to interrupt string interpretation.

        config XT804_TRAP_OUTPUT_RAMDUMP
            bool "Enable output ramdump"
            default y
            help
                Use exceptions to output ramdump.
    endif

endmenu

config W80X_BASIC_DRIVER
    bool
    default y
    select COMPONENT_DRIVER_RCC_ENABLED
    select COMPONENT_DRIVER_PMU_ENABLED
    select COMPONENT_DRIVER_IRQ_ENABLED
    select COMPONENT_DRIVER_DMA_ENABLED
    select COMPONENT_DRIVER_INTERNAL_FLASH_ENABLED
    help
        Internal use, any modification is not allowed.
```

## components/wm_wifi/Kconfig
```kconfig
menuconfig COMPONENT_WIFI_ENABLED
    depends on CHIP_HAVE_WIFI
    bool "WiFi"
    default n
    select COMPONENT_RF_ENABLED
    select COMPONENT_LWIP_ENABLED
    help
        Select this option to enable WiFi and show the submenu.

if COMPONENT_WIFI_ENABLED

    config WIFI_MASCW_TX_BUF_NUM
        int "WiFi tx buf number"
        range 1 30
        default 7
        help
            WiFi tx buf number.

    config WIFI_MASCW_RX_BUF_NUM
        int "WiFi rx buf number"
        range 1 30
        default 3
        help
            WiFi rx buf number.

    menuconfig WIFI_API_ENABLED
        bool "Enable WiFi API"
        default y
        select COMPONENT_WPA_SUPPLICANT_ENABLED
        select COMPONENT_EVENT_ENABLED
        help
            Select this option to enable WiFi Application Programming Interface.

    if WIFI_API_ENABLED
        menuconfig WIFI_ENABLE_AP_FEATURE
            select WPA_SUPPLICANT_ENABLE_AP
            bool "Enable softAP feature"
            default n
            help
                Select this option to enable softap.

        if WIFI_ENABLE_AP_FEATURE
            menu "DHCP server configuration"
                visible if !COMPONENT_NM_WIFI_SOFTAP_ENABLED

                config WIFI_DHCPS_IPV4_ADDR
                    string "IP address"
                    default "192.168.10.1"
                    help
                        Dhcp server IPV4 address in the ap mode.

                config WIFI_DHCPS_IPV4_NETMASK
                    string "Network mask"
                    default "255.255.255.0"
                    help
                        Dhcp server IPV4 netmask in the ap mode.

                config WIFI_DHCPS_IPV4_GW
                    string "Gateway address"
                    default "192.168.10.1"
                    help
                        Dhcp server IPV4 gateway in the ap mode.
            endmenu

        endif # WIFI_ENABLE_AP_FEATURE

        config WIFI_NVS_ENABLED
            bool "Enable WiFi NVS"
            default y
            select COMPONENT_NVS_ENABLED
            help
                Select this option to enable WiFi NVS.

    endif # WIFI_API_ENABLED

    orsource "macsw/Kconfig"

endif # COMPONENT_WIFI_ENABLED
```

## components/wpa_supplicant/Kconfig
```kconfig
menuconfig COMPONENT_WPA_SUPPLICANT_ENABLED
    depends on COMPONENT_WIFI_ENABLED
    bool "Wpa_supplicant"
    default n

if COMPONENT_WPA_SUPPLICANT_ENABLED

    config WPA_SUPPLICANT_ENABLE_AP
#        depends on WM_WL_ENABLE_AP
        bool "Enable AP"
        default n
        help
            Select this option to enable softap.

    config WPA_SUPPLICANT_ENABLE_SAE
        bool "Enable SAE"
        default y
        select COMPONENT_MBEDTLS_ENABLED if BUILD_TYPE_W800
        select COMPONENT_MBEDTLS_ENABLED if BUILD_TYPE_W801
        select COMPONENT_MBEDTLS_ENABLED if BUILD_TYPE_W801S
        select COMPONENT_MBEDTLS_ENABLED if BUILD_TYPE_W802
        select COMPONENT_MBEDTLS_ENABLED if BUILD_TYPE_W803
        select COMPONENT_MBEDTLS_ENABLED if BUILD_TYPE_W805
        select COMPONENT_MBEDTLS_ENABLED if BUILD_TYPE_W806
        help
            Select this option to enable SAE.
            Internal use, any modification is not allowed.

    config WPA_SUPPLICANT_HARD_CRYPTO_ENABLED
        bool "Enable HW encryption and decryption"
        select COMPONENT_DRIVER_CRYPTO_ENABLED
        select COMPONENT_DRIVER_HASH_ENABLED
        select COMPONENT_DRIVER_RNG_ENABLED
        default y
        help
            Select this option to enable hard driver to encryption and decryption.
            Internal use, any modification is not allowed.

    config WPA_SUPPLICANT_CRYPTO_HARD_BIGNUM
        depends on BUILD_TYPE_W900
        bool
        default y
        help
            Internal use, any modification is not allowed.

    config WPA_SUPPLICANT_CRYPTO_HARD_EC
        depends on BUILD_TYPE_W900
        bool
        default y
        help
            Internal use, any modification is not allowed.

    menuconfig WPA_SUPPLICANT_ENABLE_DEBUG
        bool "Enable debug"
        default n
        help
            Select this option to enable debug message.

    if WPA_SUPPLICANT_ENABLE_DEBUG

        choice WPA_SUPPLICANT_LOG_LEVEL_DEFAULT
            prompt "Default log level"
            default WPA_SUPPLICANT_LOG_LEVEL_DEBUG
            help
                Internal use, any modification is not allowed.

            config WPA_SUPPLICANT_LOG_LEVEL_ERROR
                bool "Error"
                help
                    Wpa_supplicant show error log

            config WPA_SUPPLICANT_LOG_LEVEL_WARNING
                bool "Warning"
                help
                    Wpa_supplicant show warn log

            config WPA_SUPPLICANT_LOG_LEVEL_INFO
                bool "Info"
                help
                    Wpa_supplicant show info log

            config WPA_SUPPLICANT_LOG_LEVEL_DEBUG
                bool "Debug"
                help
                    Wpa_supplicant show debug log

            config WPA_SUPPLICANT_LOG_LEVEL_MSGDUMP
                bool "Msgdump"
                help
                    Wpa_supplicant show msgdump log

            config WPA_SUPPLICANT_LOG_LEVEL_EXCESSIVE
                bool "Excessive"
                help
                    Wpa_supplicant show excessive log
        endchoice

        config WPA_SUPPLICANT_ENABLE_DEBUG_SHOW_KEYS
            bool "Debug show keys"
            default n
            help
                Select this option to enable show keys.

    endif # WPA_SUPPLICANT_ENABLE_DEBUG

endif
```

## components/yaml/Kconfig
```kconfig
menuconfig COMPONENT_YAML_ENABLED
    bool "YAML"
    default n
    help
        Select this option to enable YAML and show the submenu.

if COMPONENT_YAML_ENABLED
    config YAML_INPUT_RAW_BUFFER_SIZE
        int "input raw buffer size"
        default 512
        help
            Set yaml input raw buffer size.
            
    config YAML_OUTPUT_BUFFER_SIZE
        int "output buffer size"
        default 512
        help
            Set yaml output buffer size.
endif
```

## examples/benchmark/iperf/iperf3/Kconfig
```kconfig
config COMPONENT_IPERF3_ENABLED
    bool
    default y
    select COMPONENT_DRIVER_RNG_ENABLED
    help
        Internal use, any modification is not allowed.
```

## examples/bluetooth/central_multilink/Kconfig
```kconfig
# Copyright (c) 2021 Nordic Semiconductor ASA
# SPDX-License-Identifier: Apache-2.0

mainmenu "Bluetooth: Central Multilink"

config SAMPLE_CONN_ITERATIONS
	int "Connection iterations"
	range 0 6
	default 3
	help
	  Number of times to connect and disconnect to peripheral_identity
	  sample.

source "Kconfig.zephyr"
```

## examples/bluetooth/central_sc_general/main/Kconfig
```kconfig
menu "Example configuration"

choice CENTRAL_EXAMPLE
	prompt "selectable item central example"
	default INDICATE_EXAMPLE
	help
	  Select the central example to compile, (To work with peripheral_general example, make sure to choice the same feature).

config INDICATE_EXAMPLE
	bool "indication exmaple"
	help
	  Subscribe indication feature.
config NOTIFY_EXAMPLE
	bool "notify example"
	help
	  Subscribe notification feature.
endchoice

endmenu
```

## examples/bluetooth/peripheral_general/main/Kconfig
```kconfig
menu "Example configuration"

choice PERIPHERAL_EXAMPLE
	prompt "selectable item peripheral example"
	default INDICATE_EXAMPLE
	help
	  Select the peripheral example to compile,(To work with central_general example, make sure to choice the same feature).

config INDICATE_EXAMPLE
	bool "indication exmaple"
	help
	  Send data to centeral device via indication once subscribed.
config NOTIFY_EXAMPLE
	bool "notify example"
	help
	  Send data to centeral device via notification once subscribed..
endchoice

endmenu
```
