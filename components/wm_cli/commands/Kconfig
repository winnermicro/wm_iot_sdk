## components/wm_cli/commands/Kconfig
```kconfig
menu "Commands configuration"

    config CLI_COMMANDS_SYSTEM
        bool "Enable system cmd"
        default y
        help
            Select this option to enable system cmd.

    config CLI_COMMANDS_WIFI
        depends on COMPONENT_WIFI_ENABLED
        bool "Enable wifi cmd"
        default y
        help
            Select this option to enable wifi cmd.

    config CLI_COMMANDS_LWIP
        depends on COMPONENT_LWIP_ENABLED
        bool "Enable lwip cmd"
        default y
        help
            Select this option to enable lwip cmd.

    config CLI_COMMANDS_PARTITION_TABLE
        bool "Enable partition table cmd"
        default y
        help
            Select this option to enable partition table cmd.

    config CLI_COMMANDS_HTTP
        bool "Enable HTTP cmd"
        depends on COMPONENT_HTTP_CLIENT_ENABLED
        default y
        help
            Select this option to enable HTTP cmd.

endmenu
```

## components/wm_dt/Kconfig
```kconfig
menu "Device Table"

    config COMPONENT_DT_ENABLED
        bool
        default y
        help
            Internal use, any modification is not allowed.

    if COMPONENT_DT_ENABLED

        config DT_USE_C_STYLE_CONF
            bool "Use c style configuration"
            default n
            help
                Select this option to enable Using c code to configure directly, 
                the toml configuration file will be invalid.

    endif

endmenu
```

## components/wm_event/Kconfig
```kconfig
menuconfig COMPONENT_EVENT_ENABLED
    bool "Event"
    default n

if COMPONENT_EVENT_ENABLED

    config WM_EVENT_USE_TASK
#        bool "Event use task"
        bool
        default y
        help
            Use task process event.
            Internal use, any modificationis not allowed.

    if WM_EVENT_USE_TASK
#        config WM_EVENT_TASK_PRIO
#            int "Event task priority"
#            range 0 15
#            default 10
#            help
#                Priority used to create event task.
#
#        config WM_EVENT_TASK_STACK_SIZE
#            int "Event task stack size"
#            default 2048
#            help
#                Stack size used to create event task.

        config WM_EVENT_QUEUE_SIZE
            int "Event queue size (Number of messages)"
            range 1 512
            default 32
            help
                queue size used to create event queue.
    endif

endif
```

## components/wm_ft_param/Kconfig
```kconfig
menuconfig COMPONENT_FT_PARAM_ENABLED
    bool "FT Param"
    default y
    select COMPONENT_DRIVER_CRC_ENABLED
    help
        Internal use, any modification is not allowed.

if COMPONENT_FT_PARAM_ENABLED
    config WM_FT_PARAM_ENABLE_DATA_RESET_WHEN_GET
        bool "Enable data reset when data get"
        default n
        help
            enalbe data reset when ft param get
endif
```

## components/wm_heap/Kconfig
```kconfig
menu "Heap"

    config HEAP_USE_PSRAM
        bool
        default y if !HEAP_PSRAM_DISABLE && COMPONENT_DRIVER_PSRAM_ENABLED
        default n if HEAP_PSRAM_DISABLE || !COMPONENT_DRIVER_PSRAM_ENABLED
        help
            This option is automatically set to 'y' if HEAP_PSRAM_DISABLE is set to 'n'.
            Internal use, any modification is not allowed.

    config HEAP_USE_ASSERT
        bool "Enable heap assert"
        default y
        help
            Enable heap assert.

    config HEAP_USE_TRACING
        bool "Enable heap tracing"
        default y
        help
            Enable heap tracing.

endmenu
```

## components/wm_httpclient/Kconfig
```kconfig
menuconfig COMPONENT_HTTP_CLIENT_ENABLED
    depends on CHIP_HAVE_WIFI
    bool "Http Client"
    default n
    select COMPONENT_LWIP_ENABLED
    help
        Enable http client and show the submenu.

if COMPONENT_HTTP_CLIENT_ENABLED
    orsource "http/Kconfig"
    orsource "http2/Kconfig"
endif
```

## components/wm_httpclient/http/Kconfig
```kconfig
menu "HTTP Client"
    menuconfig WM_HTTP_CLIENT_SECURE
        bool "Enable http client secure"
        default n
        help
            Enable http client secure and show submenu.

    if WM_HTTP_CLIENT_SECURE
        config WM_HTTP_CLIENT_AUTH_BASIC
            bool "Enable auth basic"
            default n
            help
                Enable http client auth basic.

        config WM_HTTP_CLIENT_AUTH_DIGEST
            bool "Enable auth digest"
            default n
            help
                Enable http client auth digest.

        config WM_HTTP_CLIENT_AUTH_KERBEROS
            bool "Enable auth kerberos"
            default n
            help
                Enable http client auth kerberos.
    endif

    config WM_HTTP_CLIENT_PROXY
        bool "Enable http client proxy"
        default n
        help
            Enable http client proxy.

    config WM_HTTP_CLIENT_DEBUG
        bool "Enable http client debug"
        default n
        help
            Enable http client debug.
endmenu
```

## components/wm_httpclient/http2/Kconfig
```kconfig
menu "HTTP2 Client"
    config WM_HTTP2_CLIENT_ENABLED
        select WM_HTTP_CLIENT_SECURE
        select COMPONENT_POSIX_ENABLED
        bool "Enable http2 client"
        default n
        help
            Enable http2 client.

    config WM_HTTP2_CLIENT_DEBUG_ENABLED
        depends on WM_HTTP2_CLIENT_ENABLED
        bool "Enable http2 debug"
        default n
        help
            Enable http2 debug.

    config WM_HTTP2_CLIENT_LLHTTP
        depends on COMPONENT_AWS_ENABLED
        bool "Enable llhttp"
        default n
        help
            For AWS.
            Internal use, any modification is not allowed.

endmenu
```

## components/wm_log/Kconfig
```kconfig
menu "Log"

    choice LOG_PRINT_UART_MODE
        prompt "Log output port"
        default LOG_UART_PRINT_USE_UART0
        help
            Select which uart port shall be used for log output.

        config LOG_UART_PRINT_USE_UART0
            bool "Uart0"
            help
                Use uart0 print.

        config LOG_UART_PRINT_USE_UART1
            bool "Uart1"
            help
                Use uart1 print.

        config LOG_UART_PRINT_USE_UART2
            bool "Uart2"
            help
                Use uart2 print.

        config LOG_UART_PRINT_USE_UART3
            bool "Uart3"
            help
                Use uart3 print.

        config LOG_UART_PRINT_USE_UART4
            bool "Uart4"
            help
                Use uart4 print.

        if BUILD_TYPE_W801 || BUILD_TYPE_W801S || BUILD_TYPE_W802 || BUILD_TYPE_W806
            config LOG_UART_PRINT_USE_UART5
                bool "Uart5"
                help
                    Use uart5 print.
        endif

    endchoice

    config LOG_PRINT_UART_PORT
        int
        default 0 if LOG_UART_PRINT_USE_UART0
        default 1 if LOG_UART_PRINT_USE_UART1
        default 2 if LOG_UART_PRINT_USE_UART2
        default 3 if LOG_UART_PRINT_USE_UART3
        default 4 if LOG_UART_PRINT_USE_UART4
        default 5 if LOG_UART_PRINT_USE_UART5
        help
            This option will be automatically assigned a specific value based on the selection of the "LOG_UART_PRINT_USE_UARTXX".
            Internal use, any modification is not allowed.

    config LOG_PRINT_UART_DEVICE
        string
        default "uart0" if LOG_UART_PRINT_USE_UART0
        default "uart1" if LOG_UART_PRINT_USE_UART1
        default "uart2" if LOG_UART_PRINT_USE_UART2
        default "uart3" if LOG_UART_PRINT_USE_UART3
        default "uart4" if LOG_UART_PRINT_USE_UART4
        default "uart5" if LOG_UART_PRINT_USE_UART5
        help
            This option will be automatically assigned a specific value based on the selection of the "LOG_UART_PRINT_USE_UARTXX".
            Internal use, any modification is not allowed.

    config COMPONENT_LOG_ENABLED
        #bool "Enable LOG"
        bool
        default y
        help
            Select this option to enable LOG module.
            Internal use, any modification is not allowed.

    if COMPONENT_LOG_ENABLED

        choice LOG_DEFAULT_LEVEL
            prompt "Default log level"
            default LOG_DEFAULT_LEVEL_INFO
            help
                Setting static output log level and show submenu.

            config LOG_DEFAULT_LEVEL_NONE
                bool "No output"
                help
                    Not output any logs.
            config LOG_DEFAULT_LEVEL_ERROR
                bool "Error"
                help
                    Records errors that occur within the application, which may impact its functionality.
                    Only includes 'Error' log levels  if this option be choice.
            config LOG_DEFAULT_LEVEL_WARN
                bool "Warn"
                help
                    Indicates potential issues that may not cause errors but could affect the performance of the application.
                    Includes 'Warn', and 'Error' log levels if this option be choice.
            config LOG_DEFAULT_LEVEL_INFO
                bool "Info"
                help
                    Conveys general information about program operations, used to track the normal running of the application.
                    Includes 'Info', 'Warn', and 'Error' log levels if this option be choice.
            config LOG_DEFAULT_LEVEL_DEBUG
                bool "Debug"
                help
                    In-depth information for issue diagnosis, essential for development and troubleshooting.
                    Includes 'Debug', 'Info', 'Warn', and 'Error' log levels if this option be choice
            config LOG_DEFAULT_LEVEL_VERBOSE
                bool "Verbose"
                help
                    Provides detailed information, typically used for development to trace the execution of program.
                    Includes All log levels if this option be choice. Not recommended for production use.

        endchoice

        config LOG_DEFAULT_LEVEL
            int
            default 0 if LOG_DEFAULT_LEVEL_NONE
            default 1 if LOG_DEFAULT_LEVEL_ERROR
            default 2 if LOG_DEFAULT_LEVEL_WARN
            default 3 if LOG_DEFAULT_LEVEL_INFO
            default 4 if LOG_DEFAULT_LEVEL_DEBUG
            default 5 if LOG_DEFAULT_LEVEL_VERBOSE
            help
                This option will be automatically assigned a specific value based on the selection of the "LOG_DEFAULT_LEVEL_XX".
                Internal use, any modification is not allowed.

        config LOG_USE_COLOR
            bool "Enable log color"
            default n
            help
                Enable log color.

        config LOG_FORMAT_BUF_SIZE
            int
            range 64 256
            default 256
            help
                vprintf format buffer size
                Internal use, any modification is not allowed.

    endif

endmenu
```

## components/wm_net_manager/Kconfig
```kconfig
menuconfig COMPONENT_NET_MANAGER_ENABLED
    depends on CHIP_HAVE_WIFI
    select COMPONENT_LWIP_ENABLED
    select WM_LWIP
    bool "Net Manager"
    default n
    help
        Select this option to enable network manager and show submenu.

if COMPONENT_NET_MANAGER_ENABLED

    menuconfig COMPONENT_NM_WIFI_STA_ENABLED
        select COMPONENT_WIFI_ENABLED
        bool "Enable Wi-Fi station"
        default y
        help
            Select this option to enable Wi-Fi station by net manager.

    if COMPONENT_NM_WIFI_STA_ENABLED
        config NM_WIFI_STA_AUTO_CONNECT
            bool "Enable Wi-Fi auto reconnect"
            default y
            help
                Select this option to enable Wi-Fi auto reconnect.
            if NM_WIFI_STA_AUTO_CONNECT
                config NM_STA_RECONNECT_INTERVAL
                    int "Wi-Fi auto reconnect interval (ms)"
                    range 1 100000000
                    default 1000
                    help
                        Wi-Fi auto reconnect interval (millisecond).
            endif
    endif

    menuconfig COMPONENT_NM_WIFI_SOFTAP_ENABLED
        select COMPONENT_WIFI_ENABLED
        select WIFI_ENABLE_AP_FEATURE
        bool "Enable Wi-Fi softAP"
        default y
        help
            Select this option to enable Wi-Fi softAP by net manager.

        if COMPONENT_NM_WIFI_SOFTAP_ENABLED
            config NM_WIFI_SOFTAP_AUTO_CHANNEL
                bool "Auto select channel"
                default y
                help
                    Select this option to enable auto select channel.

                if !NM_WIFI_SOFTAP_AUTO_CHANNEL
                    config NM_WIFI_SOFTAP_CHANNEL
                        int "Working channel"
                            range 1 13
                            default 1
                        help
                            Wi-Fi channel (network channel) for the Wi-Fi to use.
                endif

            config NM_WIFI_SOFTAP_MAX_STA_CONN
                int "Maximum number of station connections"
                range 1 8
                default 8
                help
                    Max number of the STA connects to AP.

            menu "DHCP server configuration"

                config NM_DHCPS_IP
                    string "IP address"
                    default "192.168.10.1"
                    help
                        DHCP server IP address.
                config NM_DHCPS_NETMASK
                    string "Network mask"
                    default "255.255.255.0"
                    help
                        DHCP server netmask.
                config NM_DHCPS_GATEWAY
                    string "Gateway address"
                    default "192.168.10.1"
                    help
                        DHCP server gateway.
                config NM_DHCPS_START_IP
                    string "Assign starting IP address"
                    default "192.168.10.2"
                    help
                        DHCP server assign starting IP address.
                config NM_DHCPS_LEASE_TIME
                    int "Assign IP lease time (s)"
                    range 60 50000000
                    default 86400
                    help
                        DHCP server assign IP lease time (second).

            endmenu

        endif

endif
```

## components/wm_netif_mgr/Kconfig
```kconfig
config WM_NETIF_SELECT_LWIP
    depends on CHIP_HAVE_WIFI
    bool
    default y
    help
        Internal use, any modification is not allowed.
```

## components/wm_nvs/Kconfig
```kconfig
menuconfig COMPONENT_NVS_ENABLED
    bool "NVS"
    default n
    help
        Select this option to enable NVStore module and show the submenu.

if COMPONENT_NVS_ENABLED
    config NVS_VER_NUM
        depends on COMPONENT_NVS_ENABLED
        int
        default 0
        help
            NVS version number
            If you modify it, a different version will be detected, and then all old data will be deleted at initialize stage.

endif
```
