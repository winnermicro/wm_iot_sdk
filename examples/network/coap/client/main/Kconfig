## examples/network/coap/client/main/Kconfig
```kconfig
menu "Example configuration"

    config EXAMPLE_WIFI_SSID
        string "Wi-Fi SSID"
        default "myssid"
        help
            SSID (network name) for the example to connect to.

    config EXAMPLE_WIFI_IS_OPEN_NETWORK
            bool "Wi-Fi is open network"
            default n

        if !EXAMPLE_WIFI_IS_OPEN_NETWORK
            config EXAMPLE_WIFI_PASSWORD
                string "Wi-Fi Password"
                default "mypassword"
                help
                    Wi-Fi password (WPA or WPA2) for the example to use.
        endif

     config EXAMPLE_COAP_DEFAULT_URI
        string "Target URI"
        default "myuri"
        help
            Target URI for Coap .

    config EXAMPLE_COAP_MBEDTLS_PKI
        bool "PKI Certificates"
        default n
        help
            If the CoAP information is to be encrypted, the encryption environment
            can be set up using Public Key Infrastructure (PKI) mode.

            - Encrypt using defined Public Key Infrastructure (PKI if uri includes coaps://)
            - Note: If PSK is set as well, a server will decide which method to use
                    based on the incoming encryption request. It is up to the client
                    logic to decide which one to use.
endmenu
```

## examples/network/http2_client/main/Kconfig
```kconfig
menu "Example configuration"

    config EXAMPLE_WIFI_SSID
        string "Wi-Fi SSID"
        default "myssid"
        help
            SSID (network name) for the example to connect to.

    config EXAMPLE_WIFI_IS_OPEN_NETWORK
            bool "Wi-Fi is open network"
            default n

        if !EXAMPLE_WIFI_IS_OPEN_NETWORK
            config EXAMPLE_WIFI_PASSWORD
                string "Wi-Fi Password"
                default "mypassword"
                help
                    Wi-Fi password (WPA or WPA2) for the example to use.
        endif

    config EXAMPLE_DEFAULT_HOST
        string "Host"
        default "myhost"
        help
            Target Host for http2 server.

    config EXAMPLE_DEFAULT_PORT
        int "Port"
        default 443
        help
            Target port for http2 server.
endmenu
```

## examples/network/http_client/main/Kconfig
```kconfig
menu "Example configuration"

    config EXAMPLE_WIFI_SSID
        string "Wi-Fi SSID"
        default "myssid"
        help
            SSID (network name) for the example to connect to.

    config EXAMPLE_WIFI_IS_OPEN_NETWORK
            bool "Wi-Fi is open network"
            default n

        if !EXAMPLE_WIFI_IS_OPEN_NETWORK
            config EXAMPLE_WIFI_PASSWORD
                string "Wi-Fi Password"
                default "mypassword"
                help
                    Wi-Fi password (WPA or WPA2) for the example to use.
        endif

endmenu
```

## examples/network/httpd/http_server_post/main/Kconfig
```kconfig
menu "Example configuration"

    config EXAMPLE_WIFI_SSID
        string "Wi-Fi SSID"
        default "myssid"
        help
            SSID (network name) for the example to connect to.

    config EXAMPLE_WIFI_IS_OPEN_NETWORK
            bool "Wi-Fi is open network"
            default n

        if !EXAMPLE_WIFI_IS_OPEN_NETWORK
            config EXAMPLE_WIFI_PASSWORD
                string "Wi-Fi Password"
                default "mypassword"
                help
                    Wi-Fi password (WPA or WPA2) for the example to use.
        endif

    config EXAMPLE_HTTPS
        bool "Use https"
        default n
        help
            Use web server with http security.

    config EXAMPLE_PORT
        int "Http server port"
        default 80 if !EXAMPLE_HTTPS
	    default 443 if EXAMPLE_HTTPS
        range 0 65535
        help
            web server prot.

endmenu
```

## examples/network/ipv6_only/station/main/Kconfig
```kconfig
menu "Example configuration"

    config EXAMPLE_WIFI_SSID
        string "Wi-Fi SSID"
        default "myssid"
        help
            SSID (network name) for the example to connect to.

    config EXAMPLE_WIFI_IS_OPEN_NETWORK
            bool "Wi-Fi is open network"
            default n

        if !EXAMPLE_WIFI_IS_OPEN_NETWORK
            config EXAMPLE_WIFI_PASSWORD
                string "Wi-Fi Password"
                default "mypassword"
                help
                    Wi-Fi password (WPA or WPA2) for the example to use.
        endif

    config EXAMPLE_IPV6_ADDR
        string "IPV6 Address"
        default "FE80::30AD:E57B:C212:68AD"
        help
            IPV6 address to which the client example will send data.

    config EXAMPLE_PORT
        int "Port"
        range 0 65535
        default 3333
        help
            The remote port to which the client example will send data.

endmenu
```

## examples/network/mqtt/ssl/main/Kconfig
```kconfig
menu "Example configuration"

    config EXAMPLE_WIFI_SSID
        string "Wi-Fi SSID"
        default "myssid"
        help
            SSID (network name) for the example to connect to.

    config EXAMPLE_WIFI_IS_OPEN_NETWORK
            bool "Wi-Fi is open network"
            default n

        if !EXAMPLE_WIFI_IS_OPEN_NETWORK
            config EXAMPLE_WIFI_PASSWORD
                string "Wi-Fi Password"
                default "mypassword"
                help
                    Wi-Fi password (WPA or WPA2) for the example to use.
        endif

    config BROKER_URI
        string "Broker URL"
        default "ssl://mqtt.eclipseprojects.io:8883"
        help
            URL of an mqtt broker which this example connects to.

endmenu
```

## examples/network/net_manager/wifi_softap/main/Kconfig
```kconfig
menu "Net manager example configuration"

    config EXAMPLE_SOFTAP_SSID
        string "softAP SSID"
        default "wm-nm"
        help
            SSID (softAP) for the example to create.

    config EXAMPLE_SOFTAP_IS_OPEN_NETWORK
            bool "softAP set to open network"
            default n

        if !EXAMPLE_SOFTAP_IS_OPEN_NETWORK
            config EXAMPLE_SOFTAP_PASSWORD
                string "softAP Password"
                default "mypassword"
                help
                    Wi-Fi password (softAP) for the example to create.
        endif

endmenu
```

## examples/network/sockets/non_blocking/main/Kconfig
```kconfig
menu "Example configuration"

    config EXAMPLE_WIFI_SSID
        string "Wi-Fi SSID"
        default "myssid"
        help
            SSID (network name) for the example to connect to.

    config EXAMPLE_WIFI_IS_OPEN_NETWORK
            bool "Wi-Fi is open network"
            default n

        if !EXAMPLE_WIFI_IS_OPEN_NETWORK
            config EXAMPLE_WIFI_PASSWORD
                string "Wi-Fi Password"
                default "mypassword"
                help
                    Wi-Fi password (WPA or WPA2) for the example to use.
        endif

    config EXAMPLE_TCP_SERVER
        bool "TCP server"
        default n
        help
            This example will setup a tcp server, binds it to the specified address
            and starts listening

    if EXAMPLE_TCP_SERVER

        config EXAMPLE_TCP_SERVER_BIND_PORT
            string "Server bind port"
            default "3344"
            help
                Server listener's socket would be bound to this port.

    endif

    config EXAMPLE_TCP_CLIENT
        bool "TCP client"
        default y
        help
            This example will setup a tcp client, connects to the specified address
            and sends the data.

    if EXAMPLE_TCP_CLIENT
        config EXAMPLE_TCP_CLIENT_CONNECT_ADDRESS
            string "Client connection address or hostname"
            default "www.baidu.com"
            help
                Client's socket would connect to this address/host.

        config EXAMPLE_TCP_CLIENT_CONNECT_PORT
            string "Client connection port"
            default "80"
            help
                Client connection port.

    endif

endmenu
```

## examples/network/sockets/tcp_client/main/Kconfig
```kconfig
menu "Example configuration"

    config EXAMPLE_WIFI_SSID
        string "Wi-Fi SSID"
        default "myssid"
        help
            SSID (network name) for the example to connect to.

    config EXAMPLE_WIFI_IS_OPEN_NETWORK
            bool "Wi-Fi is open network"
            default n

        if !EXAMPLE_WIFI_IS_OPEN_NETWORK
            config EXAMPLE_WIFI_PASSWORD
                string "Wi-Fi Password"
                default "mypassword"
                help
                    Wi-Fi password (WPA or WPA2) for the example to use.
        endif

    choice EXAMPLE_IP_MODE
        prompt "IP Version"
        help
            Example can use either IPV4 or IPV6.

        config EXAMPLE_IPV4
            bool "IPV4"

        config EXAMPLE_IPV6
            bool "IPV6"
            depends on LWIP_ENABLE_IPV6

    endchoice

    config EXAMPLE_IPV4_ADDR
        string "IPV4 Address"
        default "192.168.0.165"
        depends on EXAMPLE_IPV4
        help
            The example will connect to this IPV4 address.

    config EXAMPLE_IPV6_ADDR
        string "IPV6 Address"
        default "FE80::30AD:E57B:C212:68AD"
        depends on EXAMPLE_IPV6
        help
            The example will connect to this IPV6 address.

    config EXAMPLE_PORT
        int "Port"
        range 1 65535
        default 3333
        help
            The remote port to which the client example will connect to.

endmenu
```

## examples/network/sockets/tcp_server_softap/main/Kconfig
```kconfig
menu "Example configuration"

    config EXAMPLE_WIFI_SSID
        string "Wi-Fi SSID"
        default "myssid"
        help
            SSID (network name) for the example to connect to.

    config EXAMPLE_WIFI_PASSWORD
        string "Wi-Fi Password"
        default "mypassword"
        help
            WiFi password (WPA or WPA2) for the example to use.

    config EXAMPLE_WIFI_CHANNEL
        int "WiFi Channel"
        range 1 13
        default 1
        help
            WiFi channel (network channel) for the example to use.

    config EXAMPLE_MAX_STA_CONN
        int "Maximal STA connections"
        range 1 8
        default 4
        help
            Max number of the STA connects to AP.

    config EXAMPLE_PORT
        int "Port"
        range 0 65535
        default 3333
        help
            Local port the example server will listen on.

    config EXAMPLE_KEEPALIVE_IDLE
        int "TCP keep-alive idle time(s)"
        default 5
        help
            Keep-alive idle time. In idle time without receiving any data from peer, will send keep-alive probe packet

    config EXAMPLE_KEEPALIVE_INTERVAL
        int "TCP keep-alive interval time(s)"
        default 5
        help
            Keep-alive probe packet interval time.

    config EXAMPLE_KEEPALIVE_COUNT
        int "TCP keep-alive packet retry send counts"
        default 3
        help
            Keep-alive probe packet retry count.

endmenu
```

## examples/network/sockets/udp_multicast/main/Kconfig
```kconfig
menu "Example configuration"

    config EXAMPLE_WIFI_SSID
        string "Wi-Fi SSID"
        default "myssid"
        help
            SSID (network name) for the example to connect to.

    config EXAMPLE_WIFI_IS_OPEN_NETWORK
            bool "Wi-Fi is open network"
            default n

        if !EXAMPLE_WIFI_IS_OPEN_NETWORK
            config EXAMPLE_WIFI_PASSWORD
                string "Wi-Fi Password"
                default "mypassword"
                help
                    Wi-Fi password (WPA or WPA2) for the example to use.
        endif

    choice EXAMPLE_IP_MODE
        prompt "Multicast IP type"
        help
            Example can multicast IPV4, IPV6, or both.

        config EXAMPLE_IPV4_V6
            bool "IPV4 & IPV6"
            select EXAMPLE_IPV4
            select EXAMPLE_IPV6
            depends on LWIP_ENABLE_IPV6

        config EXAMPLE_IPV4_ONLY
            bool "IPV4"
            select EXAMPLE_IPV4

        config EXAMPLE_IPV6_ONLY
            bool "IPV6"
            select EXAMPLE_IPV6
            depends on LWIP_ENABLE_IPV6

    endchoice

    config EXAMPLE_IPV4
        bool
    config EXAMPLE_IPV6
        bool
        select EXAMPLE_CONNECT_IPV6
        depends on LWIP_ENABLE_IPV6

    config EXAMPLE_MULTICAST_IPV4_ADDR
        string "Multicast IPV4 Address (send & receive)"
        default "232.10.11.12"
        depends on EXAMPLE_IPV4
        help
            IPV4 multicast address. Example will both send to and listen to this address.

    config EXAMPLE_MULTICAST_IPV6_ADDR
        string "Multicast IPV6 Address (send & receive)"
        default "FF02::FC"
        depends on EXAMPLE_IPV6
        help
            IPV6 multicast address. Example will both send to and listen to this address.

            The default FF02::FC address is a link-local multicast address.
            Consult IPV6 specifications or documentation for information about
            meaning of different IPV6 multicast ranges.

    config EXAMPLE_PORT
        int "Multicast port (send & receive)"
        range 0 65535
        default 3333
        help
            Multicast port the example will both send & receive UDP packets on.

    config EXAMPLE_MULTICAST_TTL
        int  "Multicast packet TTL"
        range 1 255
        help
            Sets TTL field of multicast packets. Separate from uni- & broadcast TTL.

endmenu
```

## examples/network/sockets/udp_server/main/Kconfig
```kconfig
menu "Example configuration"

    config EXAMPLE_WIFI_SSID
        string "Wi-Fi SSID"
        default "myssid"
        help
            SSID (network name) for the example to connect to.

    config EXAMPLE_WIFI_IS_OPEN_NETWORK
            bool "Wi-Fi is open network"
            default n

        if !EXAMPLE_WIFI_IS_OPEN_NETWORK
            config EXAMPLE_WIFI_PASSWORD
                string "Wi-Fi Password"
                default "mypassword"
                help
                    Wi-Fi password (WPA or WPA2) for the example to use.
        endif

    choice EXAMPLE_IP_MODE
        prompt "IP Version"
        help
            Example can use either IPV4 or IPV6.

        config EXAMPLE_IPV4
            bool "IPV4"

        config EXAMPLE_IPV6
            bool "IPV6"
            depends on LWIP_ENABLE_IPV6

    endchoice

    config EXAMPLE_PORT
        int "Port"
        range 0 65535
        default 3333
        help
            Local port the example server will listen on.

endmenu
```
