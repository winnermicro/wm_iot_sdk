## examples/network/static_ip/main/Kconfig
```kconfig
menu "Example configuration"

    config EXAMPLE_WIFI_SSID
        string "Wi-Fi SSID"
        default "myssid"
        help
            SSID (network name) for the example to connect to.

    config EXAMPLE_WIFI_IS_OPEN_NETWORK
            bool "Wi-Fi is open network"
            default n

        if !EXAMPLE_WIFI_IS_OPEN_NETWORK
            config EXAMPLE_WIFI_PASSWORD
                string "Wi-Fi Password"
                default "mypassword"
                help
                    Wi-Fi password (WPA or WPA2) for the example to use.
        endif

    config EXAMPLE_STATIC_IP_ADDR
        string "Static IP address"
        default "192.168.4.2"
        help
            Set static IP address.

    config EXAMPLE_STATIC_NETMASK_ADDR
        string "Static netmask address"
        default "255.255.255.0"
        help
            Set static netmask address.

    config EXAMPLE_STATIC_GW_ADDR
        string "Static gateway address"
        default "192.168.4.1"
        help
            Set static gateway address.

    choice EXAMPLE_STATIC_DNS_SERVER
        prompt "Choose DNS server"
        default EXAMPLE_STATIC_DNS_AUTO
        help
            Select auto to make gateway address as DNS server or manual to input your DNS server
        config EXAMPLE_STATIC_DNS_AUTO
            bool "Use gateway address as DNS server"
            help
                Set DNS server the same as gateway address

        config EXAMPLE_STATIC_DNS_MANUAL
            bool "Set manual value as DNS server"
            help
                Set DNS server with you want
    endchoice

    config EXAMPLE_STATIC_DNS_SERVER_MAIN
        string "Main DNS server address"
        default "192.168.4.1"
        depends on EXAMPLE_STATIC_DNS_MANUAL
        help
            Set main DNS server address.

    config EXAMPLE_STATIC_DNS_SERVER_BACKUP
        string "Backup DNS server address"
        default "192.168.4.1"
        depends on EXAMPLE_STATIC_DNS_MANUAL
        help
            Set backup DNS server address. It can be same with the main DNS server address or leave empty.

    config EXAMPLE_STATIC_DNS_RESOLVE_TEST
        bool "Enable DNS resolve test"
        default n
        help
            Enable it and configure EXAMPLE_STATIC_RESOLVE_DOMAIN to resolve DNS domain name

    config EXAMPLE_STATIC_RESOLVE_DOMAIN
        string "Domain name to resolve"
        default "www.winnermicro.com"
        depends on EXAMPLE_STATIC_DNS_RESOLVE_TEST
        help
            Set domain name for DNS test

endmenu
```

## examples/network/websocket/websocket_server/main/Kconfig
```kconfig
menu "Example configuration"

    config EXAMPLE_WIFI_SSID
        string "Wi-Fi SSID"
        default "myssid"
        help
            SSID (network name) for the example to connect to.

    config EXAMPLE_WIFI_IS_OPEN_NETWORK
            bool "Wi-Fi is open network"
            default n

        if !EXAMPLE_WIFI_IS_OPEN_NETWORK
            config EXAMPLE_WIFI_PASSWORD
                string "Wi-Fi Password"
                default "mypassword"
                help
                    Wi-Fi password (WPA or WPA2) for the example to use.
        endif

    config EXAMPLE_SECURITY
        bool "Use SSL"
        default n
        help
            Use websocket server with ssl security.

    config EXAMPLE_PORT
        int "Websocket server port"
        default 80 if !EXAMPLE_SECURITY
        default 443 if EXAMPLE_SECURITY
        range 0 65535
        help
            web server prot.

endmenu
```

## examples/ota/ota_http/main/Kconfig
```kconfig
menu "Example configuration"

    config EXAMPLE_WIFI_SSID
        string "Wi-Fi SSID"
        default "myssid"
        help
            SSID (network name) for the example to connect to.

    config EXAMPLE_WIFI_IS_OPEN_NETWORK
            bool "Wi-Fi is open network"
            default n

        if !EXAMPLE_WIFI_IS_OPEN_NETWORK
            config EXAMPLE_WIFI_PASSWORD
                string "Wi-Fi Password"
                default "mypassword"
                help
                    Wi-Fi password (WPA or WPA2) for the example to use.
        endif

    config OTA_IMAGE_URI
        string "OTA Firmware Image URL"
        default "http://xxx:xxx/ota_http_ota.img"
        help
            OTA firmware image URL for the device to download and update.

endmenu
```

## examples/project_template/main/Kconfig
```kconfig
menu "Example configuration"

menuconfig MENUCONFIG_EXAMPLE
    bool "selectable menuconfig item example"
    default n

    config MENUCONFIG_SUB_EXAMPLE_1
        bool "menuconfig item's sub item1"
        default y
        depends on MENUCONFIG_EXAMPLE
    config MENUCONFIG_SUB_EXAMPLE_2
        bool "menuconfig item's sub item2"
        default n
        depends on MENUCONFIG_EXAMPLE

endmenu
```

## examples/ref_design/ai_llm/main/Kconfig
```kconfig
menu "Example configuration"

    config EXAMPLE_WIFI_SSID
        string "WiFi SSID"
        default "myssid"
        help
            SSID (network name) for the example to connect to.

    config EXAMPLE_WIFI_IS_OPEN_NETWORK
            bool "Wi-Fi is open network"
            default n

        if !EXAMPLE_WIFI_IS_OPEN_NETWORK
            config EXAMPLE_WIFI_PASSWORD
                string "WiFi Password"
                default "mypassword"
                help
                    Wi-Fi password (WPA or WPA2) for the example to use.
        endif

endmenu
```

## examples/wifi/power_save/main/Kconfig
```kconfig
menu "Example configuration"

    config EXAMPLE_WIFI_SSID
        string "WiFi SSID"
        default "myssid"
        help
            SSID (network name) for the example to connect to.

    config EXAMPLE_WIFI_PASSWORD
        string "WiFi Password"
        default "mypassword"
        help
            WiFi password (WPA or WPA2) for the example to use.

    config EXAMPLE_WIFI_LISTEN_INTERVAL
        int "WiFi listen interval"
        default 3
        help
            Interval for station to listen to beacon from AP. The unit of listen interval is one beacon interval.
            For example, if beacon interval is 100 ms and listen interval is 3, the interval for station to listen
            to beacon is 300 ms.

    config EXAMPLE_WIFI_BEACON_TIMEOUT
        int "WiFi beacon timeout"
        default 6
        range 6 30
        help
            For Station, If the station does not receive a beacon frame from the connected SoftAP during the
            inactive time, disconnect from SoftAP. Default 6s.

    choice EXAMPLE_POWER_SAVE_MODE
        prompt "power save mode"
        default EXAMPLE_POWER_SAVE_MIN_MODEM
        help
            Modem sleep mode includes minimum and maximum power save modes.
            In minimum power save mode, station wakes up every DTIM to receive beacon. Broadcast data will not be
            lost because it is transmitted after DTIM. However, it can not save much more power if DTIM is short
            for DTIM is determined by AP.
            In maximum power save mode, station wakes up every listen interval to receive beacon. Broadcast data
            may be lost because station may be in sleep state at DTIM time. If listen interval is longer, more power
            is saved but broadcast data is more easy to lose.

        config EXAMPLE_POWER_SAVE_NONE
            bool "none"
        config EXAMPLE_POWER_SAVE_MIN_MODEM
            bool "minimum modem"
        config EXAMPLE_POWER_SAVE_MAX_MODEM
            bool "maximum modem"
    endchoice

endmenu
```

## examples/wifi/softap/main/Kconfig
```kconfig
menu "Example configuration"

    config EXAMPLE_WIFI_SSID
        string "WiFi SSID"
        default "myssid"
        help
            SSID (network name) for the example to connect to.

    config EXAMPLE_WIFI_PASSWORD
        string "WiFi Password"
        default "mypassword"
        help
            WiFi password (WPA or WPA2) for the example to use.

    config EXAMPLE_WIFI_CHANNEL
        int "WiFi Channel"
        range 1 13
        default 1
        help
            WiFi channel (network channel) for the example to use.

    config EXAMPLE_MAX_STA_CONN
        int "Maximal STA connections"
        range 1 8
        default 4
        help
            Max number of the STA connects to AP.

endmenu
```

## tools/wm/Kconfig
```kconfig
mainmenu "WinnerMicro IoT Software Development Kit Configuration"

menu "SoC configuration"

    menu "W80X"

        osource "${SDK_PATH}/components/wm_soc/w80x/Kconfig" 

        menu "Toolchain"

            comment "Path to the toolchain, see help for details"

            config TOOLCHAIN_PATH
                string "Toolchain path"
                default ""
                help
                    The absolute address of the toolchain that conforms to 
                    the current operating system's filesystem path format.
                    On Windows, such as D:\mytools\toolchain.
                    On Linux and macOS systems, such as /home/user/mytools/toolchain.

            comment "Toolchain name prefix, see help for details"

            if "${HOST_OS_TYPE}" != "Darwin"
                config TOOLCHAIN_PREFIX
                    string "Toolchain prefix"
                    default "csky-elfabiv2-" if CHIP_W80X
                    default "csky-elfabiv2-" if CHIP_W9XX
                    help
                        The prefix of the toolchain name, for example, 
                        the gcc name is cSKy-elfabiv2-gcc, then the prefix name is csky-elfabiv2-.
            endif
                
            if "${HOST_OS_TYPE}" = "Darwin"
                config TOOLCHAIN_PREFIX
                    string "Toolchain prefix"
                    default "csky-unknown-elf-" if CHIP_W80X
                    default "csky-unknown-elf-" if CHIP_W9XX
                    help
                        The prefix of the toolchain name, for example, 
                        the gcc name is cSKy-elfabiv2-gcc, then the prefix name is csky-elfabiv2-.
            endif
            
        endmenu
        
    
        choice BUILD_TYPE
            prompt "Chip type"
            default BUILD_TYPE_W800
            help
                Product build type based on specific chip/module type.

            config BUILD_TYPE_W800
                bool "W800"
                help
                    Product build type based on W800

#            config BUILD_TYPE_W801
#                bool "W801"
#                help
#                    Product build type based on W801

            config BUILD_TYPE_W801S
                bool "W801S"
                help
                    Product build type based on W801S

            config BUILD_TYPE_W802
                bool "W802"
                help
                    Product build type based on W802

            config BUILD_TYPE_W803
                bool "W803"
                help
                    Product build type based on W803

            config BUILD_TYPE_W805
                bool "W805"
                help
                    Product build type based on W805

            config BUILD_TYPE_W806
                bool "W806"
                help
                    Product build type based on W806

#            config BUILD_TYPE_W900
#                bool "W900"
#                help
#                    Product build type based on W900
        endchoice
    endmenu

    config CHIP_NAME
        string
        default "W800" if BUILD_TYPE_W800
        default "W801" if BUILD_TYPE_W801
        default "W801S" if BUILD_TYPE_W801S
        default "W802" if BUILD_TYPE_W802
        default "W803" if BUILD_TYPE_W803
        default "W805" if BUILD_TYPE_W805
        default "W806" if BUILD_TYPE_W806
        default "W900" if BUILD_TYPE_W900
        help
            Internal use, any modification is not allowed.

    config CHIP_W80X
        bool
        default y if BUILD_TYPE_W800
        default y if BUILD_TYPE_W801
        default y if BUILD_TYPE_W801S
        default y if BUILD_TYPE_W802
        default y if BUILD_TYPE_W803
        default y if BUILD_TYPE_W805
        default y if BUILD_TYPE_W806
        help
            Internal use, any modification is not allowed.

    config CHIP_W9XX
        bool
        default y if BUILD_TYPE_W900
        help
            Internal use, any modification is not allowed.

    config CHIP_FAMILY_NAME
        string
        default "w80x" if CHIP_W80X
        default "w9xx" if CHIP_W9XX
        help
            Internal use, any modification is not allowed.

    config CHIP_HAVE_RF
        bool
        default y if BUILD_TYPE_W800
        default y if BUILD_TYPE_W801
        default y if BUILD_TYPE_W801S
        default y if BUILD_TYPE_W802
        default y if BUILD_TYPE_W803
        default y if BUILD_TYPE_W900
        help
            Internal use, any modification is not allowed.

    config CHIP_HAVE_WIFI
        bool
        default y if BUILD_TYPE_W800
        default y if BUILD_TYPE_W801
        default y if BUILD_TYPE_W801S
        default y if BUILD_TYPE_W802
        default y if BUILD_TYPE_W803
        default y if BUILD_TYPE_W900
        help
            Internal use, any modification is not allowed.

    config CHIP_HAVE_BT
        bool
        default y if BUILD_TYPE_W800
        default y if BUILD_TYPE_W801
        default y if BUILD_TYPE_W801S
        default y if BUILD_TYPE_W802
        default y if BUILD_TYPE_W803
        default y if BUILD_TYPE_W900
        help
            Internal use, any modification is not allowed.

    source "${SDK_PATH}/version"
endmenu


menu "Compiler configuration"

    choice COMPILER_OPTIMIZE_LEVEL
        prompt "Optimization level"
        default COMPILER_OPTIMIZE_LEVEL_OS
        help
            This option set compiler optimization level.

        config COMPILER_OPTIMIZE_LEVEL_O0
            bool "Optimize lowest (-O0)"
            help
                Optimize for lower

        config COMPILER_OPTIMIZE_LEVEL_OS
            bool "Optimize for size (-Os)"
            help
                Optimize for size

        config COMPILER_OPTIMIZE_LEVEL_O2
            bool "Optimize for performance (-O2)"
            help
                Optimize for performance

        config COMPILER_OPTIMIZE_LEVEL_O3
            bool "Optimize for performance highest (-O3)"
            help
                Optimize for performance highest

    endchoice

    config COMPILER_DEBUG_INFORMATION
        bool "Enable debug information (-g3)"
        default y
        help
            Enable compiler generate debug information.

    config COMPILER_OPTIMIZE_CCACHE
        bool "Enable ccache"
        default y
        help
            Enable ccache improves compilation efficiency.

    config ATTRIBUTE_INLINE_ALWAYS
        bool "Enable inline always"
        default n
        help
            Enable macro ATTRIBUTE_INLINE inline always.
endmenu

osource "${SDK_PATH}/components/partition_table/config/Kconfig"

menu "Components configuration"
    osource "${SDK_PATH}/components/*/Kconfig"
endmenu

osource "${PROJECT_PATH}/*/Kconfig"
```
